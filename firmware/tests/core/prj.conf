## CMakeLists.txt
```
cmake_minimum_required(VERSION 3.20.0)
find_package(Zephyr REQUIRED HINTS $ENV{ZEPHYR_BASE})
project(mc_core_tests)

set(CORE ${CMAKE_CURRENT_LIST_DIR}/../../src/core)
file(GLOB CORE_SOURCES CONFIGURE_DEPENDS ${CORE}/*.c)
file(GLOB TEST_SOURCES CONFIGURE_DEPENDS src/*.c)
target_sources(app PRIVATE ${CORE_SOURCES} ${TEST_SOURCES})
target_include_directories(app PRIVATE ${CORE} ${CMAKE_CURRENT_BINARY_DIR})

# The contract's own examples (contracts/mqtt.md) become test inputs.
find_package(Python3 REQUIRED)
execute_process(COMMAND ${Python3_EXECUTABLE}
    ${CMAKE_CURRENT_LIST_DIR}/../../scripts/gen_contract_examples.py
    ${CMAKE_CURRENT_BINARY_DIR}/contract_examples.h
    COMMAND_ERROR_IS_FATAL ANY)
set_property(DIRECTORY APPEND PROPERTY CMAKE_CONFIGURE_DEPENDS
    ${CMAKE_CURRENT_LIST_DIR}/../../../contracts/mqtt.md
    ${CMAKE_CURRENT_LIST_DIR}/../../../contracts/ble_vectors.json
    ${CMAKE_CURRENT_LIST_DIR}/../../scripts/gen_contract_examples.py)
```

## prj.conf
```kconfig
CONFIG_ZTEST=y
CONFIG_JSON_LIBRARY=y
CONFIG_CRC=y
```

## src/test_config.c
```c
#include <zephyr/ztest.h>
#include <string.h>

#include "contract_examples.h"
#include "mc_config.h"

static bool parse(const char *json, struct mc_config *c, struct mc_error *e)
{
	char buf[1024];

	strncpy(buf, json, sizeof(buf) - 1);
	buf[sizeof(buf) - 1] = '\0';
	return mc_config_parse(buf, strlen(buf), c, e);
}

/* Parses and validates; returns the error code or NULL if the config is valid. */
static const char *verdict(const char *json, struct mc_error *e)
{
	struct mc_config c;

	if (!parse(json, &c, e)) {
		return e->code;
	}
	return mc_config_validate(&c, e) ? NULL : e->code;
}

ZTEST(config, test_contract_example_parses_and_is_valid)
{
	struct mc_config c;
	struct mc_error e;

	zassert_true(EXAMPLE_DESIRED_N >= 1);
	for (int i = 0; i < EXAMPLE_DESIRED_N; i++) {
		zassert_true(parse(example_desired[i], &c, &e), "parse: %s", e.detail);
		zassert_true(mc_config_validate(&c, &e), "%s: %s", e.code, e.detail);
	}
	zassert_true(parse(example_desired[0], &c, &e));
	zassert_equal(c.rev, 8);
	zassert_equal(c.wake_interval_s, 600);
	zassert_equal(c.n, 4);
	zassert_equal(c.slots[0].module, MC_MOD_MOISTURE_CAPACITIVE);
	zassert_equal(c.slots[0].pin, 34);
	zassert_equal(c.slots[1].cal_dry, 3050);
	zassert_equal(c.slots[2].module, MC_MOD_PUMP_RELAY);
	zassert_true(c.slots[2].active_high);
	zassert_equal(c.slots[2].max_run_s, 60);
	zassert_equal(c.slots[2].min_pause_s, 600);
	zassert_equal(c.slots[3].module, MC_MOD_DS18B20);
}

ZTEST(config, test_defaults_for_optional_fields)
{
	struct mc_config c;
	struct mc_error e;

	zassert_true(parse("{\"rev\":1,\"wake_interval_s\":900,\"slots\":["
			   "{\"slot\":0,\"module\":\"moisture_capacitive\",\"pin\":34},"
			   "{\"slot\":2,\"module\":\"pump_relay\",\"pin\":25,\"max_run_s\":10}]}",
			   &c, &e));
	zassert_equal(c.slots[0].cal_dry, MC_CAL_DRY_DEFAULT);
	zassert_equal(c.slots[0].cal_wet, MC_CAL_WET_DEFAULT);
	zassert_equal(c.slots[1].min_pause_s, 0);
	zassert_true(c.slots[1].active_high);
	zassert_true(mc_config_validate(&c, &e));
}

ZTEST(config, test_unknown_fields_are_ignored)
{
	struct mc_error e;

	zassert_is_null(verdict("{\"rev\":1,\"wake_interval_s\":600,\"future\":[1,2,{\"a\":1}],"
				"\"slots\":[{\"slot\":0,\"module\":\"moisture_capacitive\","
				"\"pin\":34,\"color\":\"red\"}]}", &e));
}

#define SLOT(module, pin, extra) "{\"slot\":0,\"module\":\"" module "\",\"pin\":" #pin extra "}"
#define DOC(slots) "{\"rev\":2,\"wake_interval_s\":600,\"slots\":[" slots "]}"

ZTEST(config, test_pin_rules)
{
	struct mc_error e;

	/* outputs on input-only pins */
	zassert_str_equal(verdict(DOC(SLOT("pump_relay", 34, ",\"max_run_s\":10")), &e),
			  "pin_not_output");
	zassert_equal(e.slot, 0);
	zassert_not_null(strstr(e.detail, "GPIO 34"));
	/* reserved: flash, UART, LED, BOOT */
	for (int pin = 0; pin < 40; pin++) {
		bool reserved = pin <= 3 || (pin >= 6 && pin <= 11);
		char doc[160];

		snprintk(doc, sizeof(doc), DOC("{\"slot\":0,\"module\":\"moisture_capacitive\","
					       "\"pin\":%d}"), pin);
		const char *v = verdict(doc, &e);

		if (reserved) {
			zassert_str_equal(v, "pin_reserved", "pin %d", pin);
		}
	}
	/* a moisture sensor on a pin without ADC */
	zassert_str_equal(verdict(DOC(SLOT("moisture_capacitive", 5, "")), &e), "out_of_range");
	/* pin beyond the GPIO range */
	zassert_str_equal(verdict(DOC(SLOT("moisture_capacitive", 99, "")), &e), "out_of_range");
	/* ADC1 and ADC2 pins are fine for sensors */
	zassert_is_null(verdict(DOC(SLOT("moisture_capacitive", 32, "")), &e));
	zassert_is_null(verdict(DOC(SLOT("moisture_capacitive", 15, "")), &e));
}

ZTEST(config, test_conflicts_and_slot_indexes)
{
	struct mc_error e;

	zassert_str_equal(verdict(DOC("{\"slot\":0,\"module\":\"moisture_capacitive\",\"pin\":34},"
				      "{\"slot\":1,\"module\":\"moisture_capacitive\",\"pin\":34}"),
				  &e), "pin_conflict");
	zassert_equal(e.slot, 1);
	zassert_not_null(strstr(e.detail, "slot 0"));
	zassert_str_equal(verdict(DOC("{\"slot\":0,\"module\":\"moisture_capacitive\",\"pin\":34},"
				      "{\"slot\":0,\"module\":\"moisture_capacitive\",\"pin\":35}"),
				  &e), "out_of_range");
	zassert_str_equal(verdict(DOC("{\"slot\":6,\"module\":\"moisture_capacitive\",\"pin\":34}"),
				  &e), "out_of_range");
}

ZTEST(config, test_modules_and_actuator_limits)
{
	struct mc_error e;

	zassert_str_equal(verdict(DOC(SLOT("laser", 25, "")), &e), "unknown_module");
	zassert_str_equal(verdict(DOC(SLOT("pump_relay", 25, "")), &e), "out_of_range"); /* no max_run_s */
	zassert_str_equal(verdict(DOC(SLOT("pump_relay", 25, ",\"max_run_s\":301")), &e),
			  "out_of_range");
	zassert_is_null(verdict(DOC(SLOT("pump_relay", 25, ",\"max_run_s\":300")), &e));
	zassert_str_equal(verdict(DOC(SLOT("moisture_capacitive", 34,
					   ",\"cal\":{\"dry\":1000,\"wet\":1000}")), &e),
			  "out_of_range");
	zassert_str_equal(verdict(DOC("{\"slot\":0,\"module\":\"sht3x\"}"), &e), "out_of_range");
	zassert_is_null(verdict(DOC("{\"slot\":0,\"module\":\"sht3x\",\"addr\":68}"), &e));
	zassert_str_equal(verdict(DOC("{\"slot\":0,\"module\":\"sht3x\",\"addr\":2}"), &e),
			  "out_of_range");
}

ZTEST(config, test_document_level_limits)
{
	struct mc_error e;

	zassert_str_equal(verdict("{\"rev\":1,\"wake_interval_s\":59,\"slots\":[]}", &e),
			  "out_of_range");
	zassert_str_equal(verdict("{\"rev\":1,\"wake_interval_s\":86401,\"slots\":[]}", &e),
			  "out_of_range");
	zassert_is_null(verdict("{\"rev\":1,\"wake_interval_s\":60,\"slots\":[]}", &e));
	zassert_str_equal(verdict("{\"wake_interval_s\":600,\"slots\":[]}", &e), "out_of_range");
	zassert_str_equal(verdict("{\"rev\":1,\"slots\":[]}", &e), "out_of_range");
	zassert_str_equal(verdict("{not json", &e), "out_of_range");
	zassert_str_equal(verdict("", &e), "out_of_range");
	/* seven slots do not fit the table */
	zassert_str_equal(verdict(DOC("{\"slot\":0},{\"slot\":1},{\"slot\":2},{\"slot\":3},"
				      "{\"slot\":4},{\"slot\":5},{\"slot\":6}"), &e), "out_of_range");
	zassert_not_null(strstr(e.detail, "at most 6"));
}

ZTEST(config, test_write_roundtrip)
{
	struct mc_config a, b;
	struct mc_error e;
	char out[768];
	struct mc_jw w;

	zassert_true(parse(example_desired[0], &a, &e));
	mc_jw_init(&w, out, sizeof(out));
	mc_jw_obj(&w);
	mc_config_write(&w, &a);
	mc_jw_end_obj(&w);
	zassert_true(mc_jw_finish(&w) > 0);
	zassert_true(parse(out, &b, &e), "%s", out);
	zassert_equal(b.rev, 8);
	zassert_true(mc_config_same(&a, &b));
	b.slots[2].max_run_s = 61;
	zassert_false(mc_config_same(&a, &b));
}

ZTEST_SUITE(config, NULL, NULL, NULL, NULL, NULL);
```

## src/test_cycle.c
```c
/* The whole wake cycle against a fake broker and fake hardware. */
#include <zephyr/ztest.h>
#include <string.h>

#include "mc_cycle.h"

#define T0 1790412000
#define MAXP 40

struct incoming {
	enum mc_in_kind kind;
	char payload[700];
};

struct fake {
	/* scripted */
	int32_t adc[MC_SLOTS_MAX];
	int32_t batt;
	int connect_rc;
	int sntp_rc;
	int64_t sntp_unix;
	int fail_publish_at;           /* publish number (1-based) that fails; 0 = never */
	struct incoming in[16];
	int n_in, in_pos;
	/* recorded */
	struct { char suffix[16]; char payload[2100]; bool retain; } pub[MAXP];
	int n_pub, n_attempts;
	char log[1024];                /* call order, e.g. "adc connect publish:status" */
	struct { int slot; bool on; bool hold; } pump[16];
	int n_pump;
	int32_t delayed_ms;
	int identify_s;
	int sntp_calls;
	int saves;
	struct mc_config saved;
	bool disconnected;
	uint32_t uptime;
};

static struct fake f;
static struct mc_rtc rtc;
static struct mc_app app;

static void note(const char *w)
{
	if (strlen(f.log) + strlen(w) + 2 < sizeof(f.log)) {
		strcat(f.log, f.log[0] ? " " : "");
		strcat(f.log, w);
	}
}

static int io_adc(void *u, const struct mc_slot *s, int32_t *raw)
{
	note("adc");
	if (f.adc[s->slot] < 0) {
		return -1;
	}
	*raw = f.adc[s->slot];
	return 0;
}
static int32_t io_batt(void *u) { return f.batt; }
static void io_pump(void *u, const struct mc_slot *s, bool on, bool hold)
{
	f.pump[f.n_pump].slot = s->slot;
	f.pump[f.n_pump].on = on;
	f.pump[f.n_pump].hold = hold;
	f.n_pump++;
	note(on ? "pump_on" : "pump_off");
}
static void io_delay(void *u, int32_t ms) { f.delayed_ms += ms; f.uptime += ms; }
static void io_identify(void *u, int32_t s) { f.identify_s = s; }
static uint32_t io_uptime(void *u) { return f.uptime; }
static int io_sntp(void *u, int64_t *t)
{
	f.sntp_calls++;
	note("sntp");
	if (f.sntp_rc) {
		return -1;
	}
	*t = f.sntp_unix + f.uptime / 1000;
	return 0;
}
static int io_save(void *u, const struct mc_config *c)
{
	f.saves++;
	f.saved = *c;
	return 0;
}
static int io_connect(void *u, const char *will, size_t len, int32_t *rssi, int32_t *wifi_ms)
{
	note("connect");
	f.uptime += 1400;
	if (f.connect_rc) {
		return -1;
	}
	zassert_equal(len, strlen("{\"state\":\"offline\"}"));
	zassert_mem_equal(will, "{\"state\":\"offline\"}", len);
	*rssi = -67;
	*wifi_ms = 1400;
	return 0;
}
static int io_publish(void *u, const char *suffix, const char *payload, size_t len, bool retain)
{
	f.n_attempts++;
	if (f.fail_publish_at && f.n_attempts == f.fail_publish_at) {
		return -1;
	}
	zassert_true(f.n_pub < MAXP);
	strcpy(f.pub[f.n_pub].suffix, suffix);
	memcpy(f.pub[f.n_pub].payload, payload, len);
	f.pub[f.n_pub].payload[len] = '\0';
	f.pub[f.n_pub].retain = retain;
	f.n_pub++;
	char tag[32];

	snprintk(tag, sizeof(tag), "pub:%s", suffix);
	note(tag);
	return 0;
}
static void io_poll(void *u, int32_t ms, mc_in_fn cb, void *cb_user)
{
	note("poll");
	f.uptime += ms;
	while (f.in_pos < f.n_in) {
		struct incoming *m = &f.in[f.in_pos++];

		cb(cb_user, m->kind, (const uint8_t *)m->payload, strlen(m->payload));
	}
}
static void io_disconnect(void *u) { f.disconnected = true; note("disconnect"); }

static const struct mc_io io = {
	.read_adc = io_adc, .battery_mv = io_batt, .pump_set = io_pump, .delay_ms = io_delay,
	.identify = io_identify, .uptime_ms = io_uptime, .sntp = io_sntp, .save_config = io_save,
	.connect = io_connect, .publish = io_publish, .poll = io_poll, .disconnect = io_disconnect,
};

static const char *CFG =
	"{\"rev\":3,\"wake_interval_s\":600,\"slots\":["
	"{\"slot\":0,\"module\":\"moisture_capacitive\",\"pin\":34,\"cal\":{\"dry\":3000,\"wet\":1200}},"
	"{\"slot\":2,\"module\":\"pump_relay\",\"pin\":25,\"active_high\":true,\"max_run_s\":60,"
	"\"min_pause_s\":0}]}";

static void give(enum mc_in_kind k, const char *payload)
{
	f.in[f.n_in].kind = k;
	strcpy(f.in[f.n_in].payload, payload);
	f.n_in++;
}

static void before(void *x)
{
	struct mc_error e;
	char doc[700];

	memset(&f, 0, sizeof(f));
	f.batt = 3900;
	f.sntp_unix = T0;
	f.adc[0] = 2100;
	memset(&rtc, 0, sizeof(rtc));
	memset(&app, 0, sizeof(app));
	strcpy(doc, CFG);
	zassert_true(mc_config_parse(doc, strlen(doc), &app.cfg, &e));
}

/* Starts an app on the retained state as it is (zeroed = power loss) and runs one cycle. */
static void cycle(enum mc_wake wake, enum mc_cfg_load cfg)
{
	struct mc_config keep = app.cfg;

	f.n_pub = f.n_attempts = f.n_pump = 0;
	f.delayed_ms = f.sntp_calls = f.saves = 0;
	f.in_pos = 0;
	f.log[0] = '\0';
	f.disconnected = false;
	mc_app_begin(&app, &rtc, &io, NULL, wake, cfg);
	if (cfg == MC_CFG_LOADED) {
		app.cfg = keep;
		app.ctx.cfg = &app.cfg;
	}
	mc_cycle(&app);
}

static void next_wake_cycle(void)
{
	/* what the hardware does between two cycles: time passes, uptime starts over */
	f.uptime = 0;
	f.n_in = 0;
}

static void sleep_for(int seconds);

static int find(const char *suffix, int from)
{
	for (int i = from; i < f.n_pub; i++) {
		if (strcmp(f.pub[i].suffix, suffix) == 0) {
			return i;
		}
	}
	return -1;
}

/* Index of the first publish on `suffix` (from `from`) whose payload contains `needle`. */
static int find_with(const char *suffix, const char *needle, int from)
{
	for (int i = from; i < f.n_pub; i++) {
		if (strcmp(f.pub[i].suffix, suffix) == 0 && strstr(f.pub[i].payload, needle)) {
			return i;
		}
	}
	return -1;
}

/* What the hardware timer does: time passes, then we wake with the retained state intact. */
static void sleep_for(int seconds)
{
	f.uptime = 0;
	f.n_in = 0;
	rtc.slept_s = (uint32_t)seconds;
	mc_rtc_seal(&rtc);
	zassert_true(mc_rtc_valid(&rtc));
}

static void expect_order(const char *const *want, size_t n)
{
	zassert_equal(f.n_pub, (int)n, "%d publishes, log: %s", f.n_pub, f.log);
	for (size_t i = 0; i < n; i++) {
		zassert_str_equal(f.pub[i].suffix, want[i], "#%d in: %s", (int)i, f.log);
	}
}

ZTEST(cycle, test_normal_cycle_follows_the_wire_sequence)
{
	cycle(MC_WAKE_POWER_ON, MC_CFG_LOADED);
	const char *want[] = {"status", "telemetry", "event", "config/state", "status"};

	expect_order(want, ARRAY_SIZE(want));
	zassert_str_equal(f.pub[0].payload,
			  "{\"state\":\"online\",\"fw\":\"" MC_FW_VERSION "\",\"boot\":1}");
	zassert_true(f.pub[0].retain);
	zassert_not_null(strstr(f.pub[1].payload, "\"seq\":1,\"ts\":17904120"));
	zassert_not_null(strstr(f.pub[1].payload, "\"value\":50.0"));
	zassert_not_null(strstr(f.pub[1].payload, "\"rssi\":-67"));
	zassert_not_null(strstr(f.pub[1].payload, "\"wake\":\"power_on\""));
	zassert_not_null(strstr(f.pub[1].payload, "\"wifi_ms\":1400"));
	zassert_false(f.pub[1].retain);
	zassert_not_null(strstr(f.pub[2].payload, "\"kind\":\"boot\""));
	zassert_not_null(strstr(f.pub[2].payload, "\"seq\":2"));
	zassert_not_null(strstr(f.pub[3].payload, "\"result\":\"boot\""));
	zassert_true(f.pub[3].retain);
	zassert_str_equal(f.pub[4].payload, "{\"state\":\"sleeping\",\"next_wake_s\":600}");
	zassert_true(f.pub[4].retain);
	zassert_true(f.disconnected);
	zassert_equal(app.next_wake_s, 600);
	zassert_true(mc_rtc_valid(&rtc)); /* sealed for the next wake */
}

ZTEST(cycle, test_sensors_are_read_before_the_radio)
{
	cycle(MC_WAKE_TIMER, MC_CFG_LOADED);
	char *adc = strstr(f.log, "adc"), *conn = strstr(f.log, "connect");

	zassert_not_null(adc);
	zassert_not_null(conn);
	zassert_true(adc < conn, "%s", f.log);
}

ZTEST(cycle, test_second_wake_is_quiet_and_keeps_counting)
{
	cycle(MC_WAKE_POWER_ON, MC_CFG_LOADED);
	next_wake_cycle();
	cycle(MC_WAKE_TIMER, MC_CFG_LOADED);
	const char *want[] = {"status", "telemetry", "status"}; /* no boot event, no config/state */

	expect_order(want, ARRAY_SIZE(want));
	zassert_not_null(strstr(f.pub[0].payload, "\"boot\":2"));
	zassert_not_null(strstr(f.pub[1].payload, "\"seq\":3")); /* 1 telemetry, 2 boot event, 3 now */
	zassert_not_null(strstr(f.pub[1].payload, "\"cycle_ms\":"));
	/* the clock carried over the sleep: no SNTP needed */
	zassert_equal(f.sntp_calls, 0);
	zassert_not_null(strstr(f.pub[1].payload, "\"ts\":1790412"));
}

ZTEST(cycle, test_failed_connect_buffers_and_the_next_cycle_sends_oldest_first)
{
	f.connect_rc = -1;
	cycle(MC_WAKE_POWER_ON, MC_CFG_LOADED);
	zassert_equal(f.n_pub, 0);
	zassert_equal(rtc.t_count, 1);
	zassert_true(mc_rtc_valid(&rtc));
	zassert_equal(app.next_wake_s, 600);
	zassert_false(f.disconnected); /* never connected */

	next_wake_cycle();
	f.connect_rc = -1;
	cycle(MC_WAKE_TIMER, MC_CFG_LOADED);
	zassert_equal(rtc.t_count, 2);

	next_wake_cycle();
	f.connect_rc = 0;
	cycle(MC_WAKE_TIMER, MC_CFG_LOADED);
	int t1 = find("telemetry", 0), t2 = find("telemetry", t1 + 1), t3 = find("telemetry", t2 + 1);

	zassert_true(t1 >= 0 && t2 > t1 && t3 > t2, "three telemetry messages, got %s", f.log);
	zassert_not_null(strstr(f.pub[t1].payload, "\"seq\":1,"));
	zassert_not_null(strstr(f.pub[t2].payload, "\"seq\":2,"));
	zassert_not_null(strstr(f.pub[t3].payload, "\"seq\":3,"));
	zassert_equal(rtc.t_count, 0);
	/* the old record has its own wake reason and no clock (it never had one) */
	zassert_not_null(strstr(f.pub[t1].payload, "\"wake\":\"power_on\""));
	zassert_is_null(strstr(f.pub[t1].payload, "\"ts\":"));
}

ZTEST(cycle, test_a_dropped_publish_keeps_the_rest_buffered)
{
	f.fail_publish_at = 2; /* status went out, the telemetry publish fails */
	cycle(MC_WAKE_POWER_ON, MC_CFG_LOADED);
	zassert_equal(rtc.t_count, 1, "still buffered");
	zassert_true(f.disconnected);
	zassert_equal(find("status", 1), -1, "no 'sleeping' on a broken connection");
	zassert_true(mc_rtc_valid(&rtc));
}

ZTEST(cycle, test_unsynced_clock_runs_sntp_and_failing_it_rejects_commands)
{
	f.sntp_rc = -1;
	give(MC_IN_CMD, "{\"id\":\"A\",\"action\":\"pump.run\",\"exp\":1790414100,"
			"\"args\":{\"slot\":2,\"seconds\":5}}");
	cycle(MC_WAKE_POWER_ON, MC_CFG_LOADED);
	zassert_equal(f.sntp_calls, 1);
	int ack = find("cmd/ack", 0);

	zassert_true(ack >= 0);
	zassert_str_equal(f.pub[ack].payload,
			  "{\"id\":\"A\",\"status\":\"rejected\",\"reason\":\"no_time\"}");
	zassert_equal(f.n_pump > 0 ? f.pump[f.n_pump - 1].on : false, false, "pump never ran");
	zassert_is_null(strstr(f.pub[find("telemetry", 0)].payload, "\"ts\":"));
}

ZTEST(cycle, test_config_is_applied_before_commands_and_reported)
{
	give(MC_IN_CMD, "{\"id\":\"A\",\"action\":\"pump.run\",\"exp\":1790414100,"
			"\"args\":{\"slot\":4,\"seconds\":5}}");
	give(MC_IN_CONFIG, "{\"rev\":4,\"wake_interval_s\":900,\"slots\":["
			   "{\"slot\":0,\"module\":\"moisture_capacitive\",\"pin\":34},"
			   "{\"slot\":4,\"module\":\"pump_relay\",\"pin\":26,\"max_run_s\":30}]}");
	cycle(MC_WAKE_TIMER, MC_CFG_LOADED);
	int cs = find("config/state", 0), ack = find("cmd/ack", 0);

	zassert_true(cs >= 0 && ack > cs, "config/state before the ack: %s", f.log);
	zassert_not_null(strstr(f.pub[cs].payload, "\"rev\":4,\"result\":\"applied\""));
	zassert_not_null(strstr(f.pub[ack].payload, "{\"id\":\"A\",\"status\":\"done\",\"ts\":17904120"));
	zassert_equal(f.saves, 1);
	zassert_equal(f.saved.rev, 4);
	zassert_equal(app.cfg.wake_interval_s, 900);
	zassert_equal(app.next_wake_s, 900);
}

ZTEST(cycle, test_rejected_config_changes_nothing)
{
	give(MC_IN_CONFIG, "{\"rev\":4,\"wake_interval_s\":600,\"slots\":["
			   "{\"slot\":2,\"module\":\"pump_relay\",\"pin\":34,\"max_run_s\":30}]}");
	cycle(MC_WAKE_TIMER, MC_CFG_LOADED);
	int cs = find("config/state", 0);

	zassert_true(cs >= 0);
	zassert_not_null(strstr(f.pub[cs].payload, "\"rev\":3,\"result\":\"rejected\",\"rejected_rev\":4"));
	zassert_not_null(strstr(f.pub[cs].payload, "\"code\":\"pin_not_output\""));
	zassert_equal(f.saves, 0);
	zassert_equal(app.cfg.rev, 3);
}

ZTEST(cycle, test_old_and_duplicate_config_revisions_are_ignored)
{
	give(MC_IN_CONFIG, "{\"rev\":3,\"wake_interval_s\":900,\"slots\":[]}");
	cycle(MC_WAKE_TIMER, MC_CFG_LOADED);
	zassert_equal(f.saves, 0);
	zassert_equal(app.cfg.wake_interval_s, 600);
}

ZTEST(cycle, test_garbage_from_the_broker_does_not_hurt)
{
	give(MC_IN_CONFIG, "{oops");
	give(MC_IN_CMD, "{also not json");
	give(MC_IN_CMD, "{\"action\":\"pump.run\"}");
	cycle(MC_WAKE_TIMER, MC_CFG_LOADED);
	zassert_equal(find("cmd/ack", 0), -1);
	zassert_true(find("status", 1) >= 0, "still went to sleep properly");
}

ZTEST(cycle, test_short_pump_run_happens_inside_the_wake)
{
	give(MC_IN_CMD, "{\"id\":\"A\",\"action\":\"pump.run\",\"exp\":1790414100,"
			"\"args\":{\"slot\":2,\"seconds\":10}}");
	cycle(MC_WAKE_TIMER, MC_CFG_LOADED);
	zassert_equal(f.delayed_ms, 10000);
	bool on = false, off_after = false;

	for (int i = 0; i < f.n_pump; i++) {
		if (f.pump[i].slot == 2 && f.pump[i].on) {
			on = true;
			zassert_false(f.pump[i].hold);
		} else if (on && f.pump[i].slot == 2) {
			off_after = true;
		}
	}
	zassert_true(on && off_after);
	zassert_false(f.pump[f.n_pump - 1].on);
	int ack = find("cmd/ack", 0);

	zassert_not_null(strstr(f.pub[ack].payload, "\"status\":\"done\""));
	zassert_equal(rtc.pump[2].run_ends_at, 0);
	zassert_true(rtc.pump[2].last_end > T0);
}

ZTEST(cycle, test_long_run_holds_through_sleep_and_ends_in_its_own_wake)
{
	give(MC_IN_CMD, "{\"id\":\"LONG\",\"action\":\"pump.run\",\"exp\":1790414100,"
			"\"args\":{\"slot\":2,\"seconds\":60}}");
	cycle(MC_WAKE_TIMER, MC_CFG_LOADED);
	zassert_equal(f.delayed_ms, 0, "the device does not babysit the pump");
	zassert_true(f.pump[f.n_pump - 1].on && f.pump[f.n_pump - 1].hold);
	int ack = find("cmd/ack", 0);

	zassert_not_null(strstr(f.pub[ack].payload, "\"status\":\"running\",\"ends_at\":17904120"));
	int sl = find("status", 1);

	zassert_true(sl > 0);
	zassert_not_null(strstr(f.pub[sl].payload, "\"next_wake_s\":")); /* shortened to the end of the run */
	zassert_true(app.next_wake_s <= 60 && app.next_wake_s >= 50, "%d", app.next_wake_s);

	/* the wake at the end of the run */
	sleep_for(60);
	cycle(MC_WAKE_PUMP_STOP, MC_CFG_LOADED);
	zassert_false(app.cold_boot, "retained state must have survived");
	zassert_false(f.pump[0].on, "pump switched off first thing");
	zassert_equal(f.pump[0].slot, 2);
	char *off = strstr(f.log, "pump_off"), *conn = strstr(f.log, "connect");

	zassert_true(off && conn && off < conn, "off before the radio: %s", f.log);
	ack = find("cmd/ack", 0);
	zassert_true(ack >= 0);
	zassert_not_null(strstr(f.pub[ack].payload, "\"id\":\"LONG\",\"status\":\"done\""));
	zassert_equal(app.next_wake_s, 600);
	zassert_equal(rtc.pump[2].run_ends_at, 0);
}

ZTEST(cycle, test_finished_run_ack_survives_a_failed_connect)
{
	give(MC_IN_CMD, "{\"id\":\"LONG\",\"action\":\"pump.run\",\"exp\":1790414100,"
			"\"args\":{\"slot\":2,\"seconds\":60}}");
	cycle(MC_WAKE_TIMER, MC_CFG_LOADED);
	sleep_for(60);
	f.connect_rc = -1; /* the wake at the end of the run has no WiFi */
	cycle(MC_WAKE_PUMP_STOP, MC_CFG_LOADED);
	zassert_false(f.pump[0].on, "pump is off regardless");
	zassert_equal(rtc.pend_n, 1, "the final ack waits");

	sleep_for(600);
	f.connect_rc = 0;
	cycle(MC_WAKE_TIMER, MC_CFG_LOADED);
	int ack = find("cmd/ack", 0);

	zassert_true(ack >= 0);
	zassert_not_null(strstr(f.pub[ack].payload, "\"id\":\"LONG\",\"status\":\"done\""));
	zassert_equal(rtc.pend_n, 0);
}

ZTEST(cycle, test_redelivered_command_is_reacked_not_rerun)
{
	give(MC_IN_CMD, "{\"id\":\"A\",\"action\":\"pump.run\",\"exp\":1790414100,"
			"\"args\":{\"slot\":2,\"seconds\":5}}");
	cycle(MC_WAKE_TIMER, MC_CFG_LOADED);
	zassert_equal(f.delayed_ms, 5000);
	next_wake_cycle();
	give(MC_IN_CMD, "{\"id\":\"A\",\"action\":\"pump.run\",\"exp\":1790414100,"
			"\"args\":{\"slot\":2,\"seconds\":5}}");
	cycle(MC_WAKE_TIMER, MC_CFG_LOADED);
	zassert_equal(f.delayed_ms, 0, "not run twice");
	int ack = find("cmd/ack", 0);

	zassert_true(ack >= 0);
	zassert_not_null(strstr(f.pub[ack].payload, "\"id\":\"A\",\"status\":\"done\""));
}

ZTEST(cycle, test_cancel_in_the_same_delivery_prevents_the_run)
{
	give(MC_IN_CMD, "{\"id\":\"A\",\"action\":\"pump.run\",\"exp\":1790414100,"
			"\"args\":{\"slot\":2,\"seconds\":5}}");
	give(MC_IN_CMD, "{\"id\":\"B\",\"action\":\"cmd.cancel\",\"exp\":1790414100,"
			"\"args\":{\"target\":\"A\"}}");
	cycle(MC_WAKE_TIMER, MC_CFG_LOADED);
	zassert_equal(f.delayed_ms, 0);
	int a1 = find("cmd/ack", 0), a2 = find("cmd/ack", a1 + 1);

	zassert_not_null(strstr(f.pub[a1].payload, "\"id\":\"A\",\"status\":\"cancelled\""));
	zassert_not_null(strstr(f.pub[a2].payload, "\"id\":\"B\",\"status\":\"done\""));
}

ZTEST(cycle, test_sensor_fault_is_reported_once_per_transition)
{
	f.adc[0] = 4095; /* nothing connected */
	cycle(MC_WAKE_TIMER, MC_CFG_LOADED);
	zassert_true(find_with("event", "\"kind\":\"sensor_fault\",\"slot\":0", 0) >= 0);
	zassert_not_null(strstr(f.pub[find("telemetry", 0)].payload, "\"error\":\"no_signal\""));
	next_wake_cycle();
	cycle(MC_WAKE_TIMER, MC_CFG_LOADED);
	zassert_equal(find("event", 0), -1, "still broken: no second event");
	next_wake_cycle();
	f.adc[0] = 2100; /* recovered */
	cycle(MC_WAKE_TIMER, MC_CFG_LOADED);
	zassert_equal(find("event", 0), -1, "recovery is silent");
	next_wake_cycle();
	f.adc[0] = 4095; /* broken again */
	cycle(MC_WAKE_TIMER, MC_CFG_LOADED);
	zassert_true(find_with("event", "sensor_fault", 0) >= 0);
}

ZTEST(cycle, test_driver_error_is_a_bus_error)
{
	f.adc[0] = -1;
	cycle(MC_WAKE_TIMER, MC_CFG_LOADED);
	zassert_not_null(strstr(f.pub[find("telemetry", 0)].payload, "\"error\":\"bus_error\""));
}

ZTEST(cycle, test_low_battery_event_once_and_longer_sleep)
{
	f.batt = 3200;
	cycle(MC_WAKE_TIMER, MC_CFG_LOADED);
	zassert_true(find_with("event", "\"kind\":\"low_battery\"", 0) >= 0);
	zassert_equal(app.next_wake_s, 1800);
	next_wake_cycle();
	cycle(MC_WAKE_TIMER, MC_CFG_LOADED);
	zassert_equal(find("event", 0), -1, "reported once");
	next_wake_cycle();
	f.batt = 3700;
	cycle(MC_WAKE_TIMER, MC_CFG_LOADED);
	next_wake_cycle();
	f.batt = 3200;
	cycle(MC_WAKE_TIMER, MC_CFG_LOADED);
	zassert_true(find_with("event", "low_battery", 0) >= 0, "reported again after a recovery");
}

ZTEST(cycle, test_service_mode_stays_awake_and_handles_messages)
{
	give(MC_IN_CMD, "{\"id\":\"S\",\"action\":\"device.service\",\"exp\":1790414100,"
			"\"args\":{\"minutes\":1}}");
	cycle(MC_WAKE_TIMER, MC_CFG_LOADED);
	int st = find("status", 1);

	zassert_true(st > 0);
	zassert_not_null(strstr(f.pub[st].payload, "\"state\":\"service\",\"until_s\":"));
	zassert_true(f.uptime >= 60000, "stayed awake about a minute, uptime %u", (unsigned)f.uptime);
	int sl = find("status", st + 1);

	zassert_true(sl > st);
	zassert_not_null(strstr(f.pub[sl].payload, "\"state\":\"sleeping\""));
	zassert_not_null(strstr(f.pub[find("event", 0)].payload, "\"kind\":\"boot\"")); /* cold boot first */
}

ZTEST(cycle, test_identify_and_reboot)
{
	give(MC_IN_CMD, "{\"id\":\"I\",\"action\":\"device.identify\",\"exp\":1790414100,"
			"\"args\":{\"seconds\":7}}");
	give(MC_IN_CMD, "{\"id\":\"R\",\"action\":\"device.reboot\",\"exp\":1790414100}");
	cycle(MC_WAKE_TIMER, MC_CFG_LOADED);
	zassert_equal(f.identify_s, 7);
	zassert_true(app.reboot);
	zassert_true(find("cmd/ack", 0) >= 0);
	/* the ack was sent before anything restarts */
}

ZTEST(cycle, test_corrupt_stored_config_reports_an_error_and_runs_the_default)
{
	cycle(MC_WAKE_POWER_ON, MC_CFG_CORRUPT);
	int ev = find("event", 0), ev2 = find("event", ev + 1);

	zassert_true(ev >= 0 && ev2 > ev);
	zassert_not_null(strstr(f.pub[ev2].payload, "\"kind\":\"config_error\""));
	zassert_equal(app.cfg.n, 0);
	zassert_not_null(strstr(f.pub[find("telemetry", 0)].payload, "\"readings\":[]"));
}

ZTEST(cycle, test_first_boot_without_config_is_not_an_error)
{
	cycle(MC_WAKE_POWER_ON, MC_CFG_MISSING);
	int ev = find("event", 0);

	zassert_true(ev >= 0);
	zassert_is_null(strstr(f.pub[ev].payload, "config_error"));
	zassert_equal(find("event", ev + 1), -1);
}

ZTEST(cycle, test_a_config_change_switches_pumps_off)
{
	give(MC_IN_CMD, "{\"id\":\"LONG\",\"action\":\"pump.run\",\"exp\":1790414100,"
			"\"args\":{\"slot\":2,\"seconds\":60}}");
	cycle(MC_WAKE_TIMER, MC_CFG_LOADED);
	sleep_for(10);
	give(MC_IN_CONFIG, "{\"rev\":9,\"wake_interval_s\":600,\"slots\":[]}");
	cycle(MC_WAKE_TIMER, MC_CFG_LOADED);
	zassert_false(app.cold_boot);
	zassert_false(f.pump[f.n_pump - 1].on);
	zassert_equal(rtc.pump[2].run_ends_at, 0);
	int ack = find("cmd/ack", 0);

	zassert_true(ack >= 0);
	zassert_not_null(strstr(f.pub[ack].payload, "\"id\":\"LONG\",\"status\":\"cancelled\""));
}

ZTEST_SUITE(cycle, NULL, NULL, before, NULL, NULL);

ZTEST(cycle, test_long_run_on_a_pin_without_rtc_hold_stays_awake)
{
	/* GPIO 18 cannot keep its level in deep sleep: the run happens inside the wake */
	struct mc_error e;
	char doc[] = "{\"rev\":3,\"wake_interval_s\":600,\"slots\":["
		     "{\"slot\":2,\"module\":\"pump_relay\",\"pin\":18,\"max_run_s\":60}]}";

	zassert_true(mc_config_parse(doc, strlen(doc), &app.cfg, &e));
	give(MC_IN_CMD, "{\"id\":\"LONG\",\"action\":\"pump.run\",\"exp\":1790414100,"
			"\"args\":{\"slot\":2,\"seconds\":40}}");
	cycle(MC_WAKE_TIMER, MC_CFG_LOADED);
	zassert_equal(f.delayed_ms, 40000);
	zassert_false(f.pump[f.n_pump - 1].on);
	for (int i = 0; i < f.n_pump; i++) {
		zassert_false(f.pump[i].hold);
	}
	zassert_not_null(strstr(f.pub[find("cmd/ack", 0)].payload, "\"status\":\"done\""));
	zassert_equal(app.next_wake_s, 600);
}

ZTEST(cycle, test_button_wake_enters_service_mode_once_the_clock_is_known)
{
	mc_app_begin(&app, &rtc, &io, NULL, MC_WAKE_BUTTON, MC_CFG_LOADED);
	app.service_request_s = 60;
	f.log[0] = '\0';
	mc_cycle(&app);
	zassert_true(f.uptime >= 60000, "stayed up, uptime %u", (unsigned)f.uptime);
	zassert_not_null(strstr(f.pub[find("status", 1)].payload, "\"state\":\"service\""));
}

/*
 * Prints every message of a few rich cycles as `MCPUB <topic suffix> <payload>`.
 * scripts/test.py feeds them to the Python contract models (mc_core) that the gateway
 * and the API parse them with: the firmware must produce what the server accepts.
 */
static void dump(void)
{
	for (int i = 0; i < f.n_pub; i++) {
		printk("MCPUB %s %s\n", f.pub[i].suffix, f.pub[i].payload);
	}
}

ZTEST(cycle, test_dump_messages_for_the_contract_check)
{
	/* cold boot: broken sensor, low battery, cancel, rejected and accepted commands */
	f.adc[0] = 4095;
	f.batt = 3200;
	give(MC_IN_CONFIG, "{\"rev\":5,\"wake_interval_s\":900,\"slots\":["
			   "{\"slot\":0,\"module\":\"moisture_capacitive\",\"pin\":34,"
			   "\"cal\":{\"dry\":3000,\"wet\":1200}},"
			   "{\"slot\":1,\"module\":\"ds18b20\",\"pin\":27},"
			   "{\"slot\":2,\"module\":\"pump_relay\",\"pin\":25,\"max_run_s\":120,"
			   "\"min_pause_s\":0}]}");
	give(MC_IN_CMD, "{\"id\":\"RUN\",\"action\":\"pump.run\",\"exp\":1790414100,"
			"\"args\":{\"slot\":2,\"seconds\":5}}");
	give(MC_IN_CMD, "{\"id\":\"BAD\",\"action\":\"pump.run\",\"exp\":1790414100,"
			"\"args\":{\"slot\":2,\"seconds\":500}}");
	give(MC_IN_CMD, "{\"id\":\"OLD\",\"action\":\"pump.run\",\"exp\":1,\"args\":{\"slot\":2,\"seconds\":5}}");
	give(MC_IN_CMD, "{\"id\":\"LONG\",\"action\":\"pump.run\",\"exp\":1790414100,"
			"\"args\":{\"slot\":2,\"seconds\":90}}");
	give(MC_IN_CMD, "{\"id\":\"CXL\",\"action\":\"cmd.cancel\",\"exp\":1790414100,"
			"\"args\":{\"target\":\"LONG\"}}");
	give(MC_IN_CMD, "{\"id\":\"ID\",\"action\":\"device.identify\",\"exp\":1790414100}");
	cycle(MC_WAKE_POWER_ON, MC_CFG_LOADED);
	dump();

	/* a rejected config, then a held long run and its end */
	sleep_for(900);
	give(MC_IN_CONFIG, "{\"rev\":6,\"wake_interval_s\":900,\"slots\":["
			   "{\"slot\":2,\"module\":\"pump_relay\",\"pin\":34,\"max_run_s\":10}]}");
	give(MC_IN_CMD, "{\"id\":\"LONG2\",\"action\":\"pump.run\",\"exp\":1790414100,"
			"\"args\":{\"slot\":2,\"seconds\":100}}");
	cycle(MC_WAKE_TIMER, MC_CFG_LOADED);
	dump();
	sleep_for(100);
	cycle(MC_WAKE_PUMP_STOP, MC_CFG_LOADED);
	dump();
	zassert_true(f.n_pub > 0);
}
```

## src/test_json.c
```c
#include <zephyr/ztest.h>
#include <string.h>

#include "mc_json.h"

static int build(char *buf, size_t cap, void (*fn)(struct mc_jw *))
{
	struct mc_jw w;

	mc_jw_init(&w, buf, cap);
	fn(&w);
	return mc_jw_finish(&w);
}

static void compose(struct mc_jw *w)
{
	mc_jw_obj(w);
	mc_jw_kv_int(w, "a", 1);
	mc_jw_kv_str(w, "s", "x");
	mc_jw_key(w, "list");
	mc_jw_arr(w);
	mc_jw_int(w, -5);
	mc_jw_obj(w);
	mc_jw_kv_bool(w, "t", true);
	mc_jw_end_obj(w);
	mc_jw_end_arr(w);
	mc_jw_key(w, "o");
	mc_jw_obj(w);
	mc_jw_end_obj(w);
	mc_jw_end_obj(w);
}

ZTEST(json, test_compact_nesting_and_commas)
{
	char buf[128];

	zassert_true(build(buf, sizeof(buf), compose) > 0);
	zassert_str_equal(buf, "{\"a\":1,\"s\":\"x\",\"list\":[-5,{\"t\":true}],\"o\":{}}");
}

static void escapes(struct mc_jw *w)
{
	mc_jw_str(w, "q\"b\\n\n\x01\xC2\xB0");
}

ZTEST(json, test_escaping_keeps_utf8)
{
	char buf[64];

	zassert_true(build(buf, sizeof(buf), escapes) > 0);
	zassert_str_equal(buf, "\"q\\\"b\\\\n\\u000a\\u0001\xC2\xB0\"");
}

static void decimals(struct mc_jw *w)
{
	mc_jw_arr(w);
	mc_jw_dec1(w, 415);
	mc_jw_dec1(w, 0);
	mc_jw_dec1(w, 5);
	mc_jw_dec1(w, -75);
	mc_jw_dec1(w, 1000);
	mc_jw_int(w, INT64_MIN);
	mc_jw_end_arr(w);
}

ZTEST(json, test_one_decimal_and_extremes)
{
	char buf[96];

	zassert_true(build(buf, sizeof(buf), decimals) > 0);
	zassert_str_equal(buf, "[41.5,0.0,0.5,-7.5,100.0,-9223372036854775808]");
}

ZTEST(json, test_overflow_is_reported_not_written)
{
	char buf[8];

	zassert_equal(build(buf, sizeof(buf), compose), -1);
	zassert_true(strlen(buf) < sizeof(buf));
}

ZTEST_SUITE(json, NULL, NULL, NULL, NULL, NULL);
```

## src/test_payload.c
```c
#include <zephyr/ztest.h>
#include <string.h>

#include "mc_payload.h"

#define CAP 600

ZTEST(payload, test_status_messages)
{
	char b[128];

	zassert_true(mc_enc_status_online(b, sizeof(b), 5521) > 0);
	zassert_str_equal(b, "{\"state\":\"online\",\"fw\":\"" MC_FW_VERSION "\",\"boot\":5521}");
	zassert_true(mc_enc_status_sleeping(b, sizeof(b), 600) > 0);
	zassert_str_equal(b, "{\"state\":\"sleeping\",\"next_wake_s\":600}");
	zassert_true(mc_enc_status_offline(b, sizeof(b)) > 0);
	zassert_str_equal(b, "{\"state\":\"offline\"}");
	zassert_true(mc_enc_status_service(b, sizeof(b), 900) > 0);
	zassert_str_equal(b, "{\"state\":\"service\",\"until_s\":900}");
}

ZTEST(payload, test_telemetry_matches_contract_example)
{
	/* mqtt.md §4.2: two soil sensors (one without signal) and a temperature. */
	struct mc_tel t = {
		.seq = 18422, .ts = 1790412305, .cfg_rev = 8, .n = 3,
		.r = {
			{.slot = 0, .type = MC_TYPE_SOIL_MOISTURE, .has_value = true,
			 .value_x10 = 415, .has_raw = true, .raw = 2143},
			{.slot = 1, .type = MC_TYPE_SOIL_MOISTURE, .err = MC_SENSOR_NO_SIGNAL,
			 .has_raw = true, .raw = 4095},
			{.slot = 3, .type = MC_TYPE_TEMPERATURE, .has_value = true, .value_x10 = 213},
		},
		.h = {.batt_mv = 3910, .rssi = -67, .wake = MC_WAKE_TIMER, .cycle_ms = 2140,
		      .wifi_ms = 1450},
	};
	char b[CAP];

	zassert_true(mc_enc_telemetry(b, sizeof(b), &t) > 0);
	zassert_str_equal(b,
		"{\"seq\":18422,\"ts\":1790412305,\"cfg_rev\":8,\"readings\":["
		"{\"slot\":0,\"type\":\"soil_moisture\",\"value\":41.5,\"unit\":\"%\",\"raw\":2143},"
		"{\"slot\":1,\"type\":\"soil_moisture\",\"error\":\"no_signal\",\"raw\":4095},"
		"{\"slot\":3,\"type\":\"temperature\",\"value\":21.3,\"unit\":\"\xC2\xB0" "C\"}],"
		"\"health\":{\"batt_mv\":3910,\"rssi\":-67,\"wake\":\"timer\",\"cycle_ms\":2140,"
		"\"wifi_ms\":1450}}");
}

ZTEST(payload, test_telemetry_omits_unknown_fields)
{
	struct mc_tel t = {.seq = 1, .ts = 0, .cfg_rev = 0, .n = 0,
			   .h = {.batt_mv = 3700, .rssi = -80, .wake = MC_WAKE_POWER_ON,
				 .cycle_ms = -1, .wifi_ms = -1}};
	char b[CAP];

	zassert_true(mc_enc_telemetry(b, sizeof(b), &t) > 0);
	zassert_str_equal(b, "{\"seq\":1,\"cfg_rev\":0,\"readings\":[],"
			     "\"health\":{\"batt_mv\":3700,\"rssi\":-80,\"wake\":\"power_on\"}}");
}

ZTEST(payload, test_events)
{
	struct mc_event e = {.seq = 18423, .ts = 1790412306, .kind = MC_EV_SAFETY_STOP, .slot = 2,
			     .detail = "max_run_s reached"};
	char b[CAP];

	zassert_true(mc_enc_event(b, sizeof(b), &e) > 0);
	zassert_str_equal(b, "{\"seq\":18423,\"ts\":1790412306,\"kind\":\"safety_stop\",\"slot\":2,"
			     "\"detail\":\"max_run_s reached\"}");
	e = (struct mc_event){.seq = 9, .kind = MC_EV_BOOT, .slot = -1};
	zassert_true(mc_enc_event(b, sizeof(b), &e) > 0);
	zassert_str_equal(b, "{\"seq\":9,\"kind\":\"boot\"}");
}

ZTEST(payload, test_acks_match_contract_examples)
{
	char b[CAP];
	struct mc_ack a = {.id = "01J8ZQ6H7K2M4N5P6Q7R8S9T0V", .status = MC_ACK_DONE,
			   .ts = 1790412318};

	zassert_true(mc_enc_ack(b, sizeof(b), &a) > 0);
	zassert_str_equal(b, "{\"id\":\"01J8ZQ6H7K2M4N5P6Q7R8S9T0V\",\"status\":\"done\","
			     "\"ts\":1790412318}");
	a = (struct mc_ack){.id = "01J8ZQ6H7K2M4N5P6Q7R8S9T0V", .status = MC_ACK_RUNNING,
			    .ends_at = 1790413500};
	zassert_true(mc_enc_ack(b, sizeof(b), &a) > 0);
	zassert_str_equal(b, "{\"id\":\"01J8ZQ6H7K2M4N5P6Q7R8S9T0V\",\"status\":\"running\","
			     "\"ends_at\":1790413500}");
	a = (struct mc_ack){.id = "01J8ZQ6H7K2M4N5P6Q7R8S9T0V", .status = MC_ACK_REJECTED,
			    .reason = "expired"};
	zassert_true(mc_enc_ack(b, sizeof(b), &a) > 0);
	zassert_str_equal(b, "{\"id\":\"01J8ZQ6H7K2M4N5P6Q7R8S9T0V\",\"status\":\"rejected\","
			     "\"reason\":\"expired\"}");
}

ZTEST(payload, test_config_state_applied_and_rejected)
{
	struct mc_config c;
	struct mc_error err = {.slot = 2, .code = "pin_not_output"};
	char b[CAP];

	mc_config_init(&c);
	c.rev = 7;
	c.n = 2;
	c.slots[0] = (struct mc_slot){.slot = 0, .module = MC_MOD_MOISTURE_CAPACITIVE, .pin = 34,
				      .cal_dry = 3000, .cal_wet = 1200};
	c.slots[1] = (struct mc_slot){.slot = 2, .module = MC_MOD_PUMP_RELAY, .pin = 25,
				      .active_high = true, .max_run_s = 60, .min_pause_s = 600};
	strcpy(err.detail, "GPIO 34 is input-only");

	zassert_true(mc_enc_config_state(b, sizeof(b), &c, MC_CFG_REJECTED, 8, &err) > 0);
	zassert_str_equal(b,
		"{\"rev\":7,\"result\":\"rejected\",\"rejected_rev\":8,\"error\":{\"slot\":2,"
		"\"code\":\"pin_not_output\",\"detail\":\"GPIO 34 is input-only\"},"
		"\"wake_interval_s\":600,\"slots\":["
		"{\"slot\":0,\"module\":\"moisture_capacitive\",\"pin\":34,"
		"\"cal\":{\"dry\":3000,\"wet\":1200}},"
		"{\"slot\":2,\"module\":\"pump_relay\",\"pin\":25,\"active_high\":true,"
		"\"max_run_s\":60,\"min_pause_s\":600}],\"detected\":[],"
		"\"limits\":{\"max_run_s_hard\":300,\"slots_max\":6}}");
	zassert_true(mc_enc_config_state(b, sizeof(b), &c, MC_CFG_BOOT, 0, NULL) > 0);
	zassert_not_null(strstr(b, "\"result\":\"boot\""));
	zassert_is_null(strstr(b, "rejected_rev"));
}

ZTEST(payload, test_too_small_buffer_fails)
{
	char b[10];

	zassert_equal(mc_enc_status_online(b, sizeof(b), 1), -1);
}

ZTEST_SUITE(payload, NULL, NULL, NULL, NULL, NULL);
```

## src/test_sensor_rtc.c
```c
#include <zephyr/ztest.h>
#include <string.h>

#include "mc_rtc.h"
#include "mc_sensor.h"

ZTEST(sensor, test_moisture_calibration)
{
	int32_t v;

	/* dry 3000 = 0 %, wet 1200 = 100 % */
	zassert_equal(mc_moisture_convert(3000, 3000, 1200, &v), MC_SENSOR_OK);
	zassert_equal(v, 0);
	zassert_equal(mc_moisture_convert(1200, 3000, 1200, &v), MC_SENSOR_OK);
	zassert_equal(v, 1000);
	zassert_equal(mc_moisture_convert(2100, 3000, 1200, &v), MC_SENSOR_OK);
	zassert_equal(v, 500);
	zassert_equal(mc_moisture_convert(2143, 3000, 1200, &v), MC_SENSOR_OK);
	zassert_equal(v, 476); /* 47.6 % */
	/* slightly outside the span is clamped, far outside is an error */
	zassert_equal(mc_moisture_convert(3100, 3000, 1200, &v), MC_SENSOR_OK);
	zassert_equal(v, 0);
	zassert_equal(mc_moisture_convert(1100, 3000, 1200, &v), MC_SENSOR_OK);
	zassert_equal(v, 1000);
	zassert_equal(mc_moisture_convert(3500, 3000, 1200, &v), MC_SENSOR_OUT_OF_RANGE);
	zassert_equal(mc_moisture_convert(800, 3000, 1200, &v), MC_SENSOR_OUT_OF_RANGE);
}

ZTEST(sensor, test_nothing_connected)
{
	int32_t v;

	zassert_equal(mc_moisture_convert(4095, 3000, 1200, &v), MC_SENSOR_NO_SIGNAL);
	zassert_equal(mc_moisture_convert(0, 3000, 1200, &v), MC_SENSOR_NO_SIGNAL);
}

ZTEST(sensor, test_resistive_orientation_is_handled)
{
	int32_t v;

	/* a sensor that reads higher when wet: dry < wet */
	zassert_equal(mc_moisture_convert(1000, 1000, 3000, &v), MC_SENSOR_OK);
	zassert_equal(v, 0);
	zassert_equal(mc_moisture_convert(2000, 1000, 3000, &v), MC_SENSOR_OK);
	zassert_equal(v, 500);
}

ZTEST(sensor, test_reading_from_slot)
{
	struct mc_slot s = {.slot = 1, .module = MC_MOD_MOISTURE_CAPACITIVE, .cal_dry = 3000,
			    .cal_wet = 1200};
	struct mc_reading r;

	mc_moisture_reading(&s, 2100, &r);
	zassert_true(r.has_value && r.has_raw);
	zassert_equal(r.slot, 1);
	zassert_equal(r.value_x10, 500);
	mc_moisture_reading(&s, 4095, &r);
	zassert_false(r.has_value);
	zassert_equal(r.err, MC_SENSOR_NO_SIGNAL);
	zassert_equal(r.raw, 4095);
}

ZTEST_SUITE(sensor, NULL, NULL, NULL, NULL, NULL);

static struct mc_rtc rtc;

static void before(void *f)
{
	mc_rtc_init(&rtc);
}

static struct mc_tel tel(uint32_t seq)
{
	return (struct mc_tel){.seq = seq, .n = 0};
}

ZTEST(rtc, test_crc_detects_power_loss_and_corruption)
{
	zassert_false(mc_rtc_valid(&rtc)); /* not sealed yet */
	mc_rtc_seal(&rtc);
	zassert_true(mc_rtc_valid(&rtc));
	rtc.seq++;
	zassert_false(mc_rtc_valid(&rtc));
	mc_rtc_seal(&rtc);
	zassert_true(mc_rtc_valid(&rtc));

	struct mc_rtc garbage;

	memset(&garbage, 0xA5, sizeof(garbage));
	zassert_false(mc_rtc_valid(&garbage));
	memset(&garbage, 0, sizeof(garbage));
	zassert_false(mc_rtc_valid(&garbage));
}

ZTEST(rtc, test_fits_in_retained_ram)
{
	zassert_true(sizeof(struct mc_rtc) <= 4000, "%u bytes", (unsigned)sizeof(struct mc_rtc));
}

ZTEST(rtc, test_seq_is_monotonic)
{
	zassert_equal(mc_rtc_next_seq(&rtc), 1);
	zassert_equal(mc_rtc_next_seq(&rtc), 2);
}

ZTEST(rtc, test_buffer_keeps_order_and_drops_oldest)
{
	zassert_is_null(mc_tbuf_oldest(&rtc));
	for (uint32_t i = 1; i <= 9; i++) { /* 3 more than the 6 it holds */
		struct mc_tel t = tel(i);

		mc_tbuf_push(&rtc, &t);
	}
	zassert_equal(rtc.t_count, MC_TELEMETRY_BUFFER);
	for (uint32_t expect = 4; expect <= 9; expect++) {
		const struct mc_tel *t = mc_tbuf_oldest(&rtc);

		zassert_not_null(t);
		zassert_equal(t->seq, expect);
		mc_tbuf_drop_oldest(&rtc);
	}
	zassert_is_null(mc_tbuf_oldest(&rtc));
	mc_tbuf_drop_oldest(&rtc); /* harmless when empty */
}

ZTEST(rtc, test_next_wake_interval)
{
	struct mc_config cfg;

	mc_config_init(&cfg);
	cfg.wake_interval_s = 600;

	struct mc_ctx ctx = {.cfg = &cfg, .now = 1000, .time_synced = true, .hist = &rtc.hist};

	zassert_equal(mc_next_wake_s(&ctx, 3900), 600);
	zassert_equal(mc_next_wake_s(&ctx, 3200), 1800); /* low battery: less often */
	zassert_equal(mc_next_wake_s(&ctx, 0), 600);     /* no battery reading */
	cfg.wake_interval_s = 40000;
	zassert_equal(mc_next_wake_s(&ctx, 3200), MC_WAKE_INTERVAL_MAX_S);
	cfg.wake_interval_s = 600;
	/* a held pump run ends in 90 s: wake for that instead */
	mc_pump_begin_hold(&ctx.pump[2], "X", 1090);
	zassert_equal(mc_next_wake_s(&ctx, 3900), 90);
	ctx.now = 1095; /* overdue: wake right away */
	zassert_equal(mc_next_wake_s(&ctx, 3900), 1);
}

ZTEST_SUITE(rtc, NULL, NULL, before, NULL, NULL);

#include "mc_pins.h"

ZTEST(pins, test_adc_mapping_matches_the_esp32)
{
	int unit, ch;

	zassert_true(mc_pin_adc(34, &unit, &ch));
	zassert_equal(unit, 1);
	zassert_equal(ch, 6);
	zassert_true(mc_pin_adc(36, &unit, &ch));
	zassert_equal(ch, 0);
	zassert_true(mc_pin_adc(39, &unit, &ch));
	zassert_equal(ch, 3);
	zassert_true(mc_pin_adc(32, &unit, &ch));
	zassert_equal(ch, 4);
	zassert_true(mc_pin_adc(15, &unit, &ch));
	zassert_equal(unit, 2);
	zassert_equal(ch, 3); /* "D15 is ADC2 channel 3" */
	zassert_true(mc_pin_adc(25, &unit, &ch));
	zassert_equal(ch, 8);
	zassert_true(mc_pin_adc(27, &unit, &ch));
	zassert_equal(ch, 7);
	zassert_false(mc_pin_adc(5, &unit, &ch));
	zassert_false(mc_pin_adc(40, &unit, &ch));
	zassert_false(mc_pin_adc(-1, &unit, &ch));
}

ZTEST(pins, test_every_adc_pin_the_config_allows_is_mapped)
{
	/* the pins the config accepts for moisture sensors (mc_config.c adc_mask) */
	static const int allowed[] = {32, 33, 34, 35, 36, 39, 4, 12, 13, 14, 15, 25, 26, 27};
	int unit, ch;

	for (size_t i = 0; i < ARRAY_SIZE(allowed); i++) {
		zassert_true(mc_pin_adc(allowed[i], &unit, &ch), "GPIO %d", allowed[i]);
	}
}

ZTEST(pins, test_rtc_pins)
{
	zassert_true(mc_pin_rtc_capable(25));
	zassert_true(mc_pin_rtc_capable(32));
	zassert_false(mc_pin_rtc_capable(5));
	zassert_false(mc_pin_rtc_capable(18));
	zassert_false(mc_pin_rtc_capable(23));
}

ZTEST_SUITE(pins, NULL, NULL, NULL, NULL, NULL);
```
