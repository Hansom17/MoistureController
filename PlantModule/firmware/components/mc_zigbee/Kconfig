## PlantModule/firmware/components/mc_zigbee/Kconfig
```kconfig
menu "PlantModule Zigbee"

    config MC_ZIGBEE_STUB
        bool "Use the stub instead of the Zigbee stack (bench tests without a radio)"
        default n

    config MC_ZB_TX_POWER
        int "Zigbee transmit power in dBm"
        range -24 20
        default 10
        help
            Lower values draw less current, which matters on a weak USB supply during bench tests.

endmenu
```

## PlantModule/firmware/main/Kconfig.projbuild
```kconfig
menu "PlantModule"

    config MC_DEV_BOARD
        string "Board used when the factory partition is empty (development only)"
        default ""
        help
            A module made by the provisioning tool carries its board name in the factory partition. With this
            option set (for example "devkitc-1") a board without factory data runs as that board instead of
            entering safe mode. Leave empty in a release build.

    config MC_DEV_JOIN
        bool "Join with the default link key when no install code is stored (development only)"
        default n

endmenu
```

## PlantModule/firmware/sdkconfig.defaults
```kconfig
CONFIG_IDF_TARGET="esp32c6"
CONFIG_PARTITION_TABLE_CUSTOM=y
CONFIG_PARTITION_TABLE_CUSTOM_FILENAME="partitions.csv"
CONFIG_PARTITION_TABLE_FILENAME="partitions.csv"
CONFIG_ESPTOOLPY_FLASHSIZE_4MB=y
CONFIG_COMPILER_OPTIMIZATION_SIZE=y
CONFIG_ESP_TASK_WDT_EN=y
CONFIG_ESP_TASK_WDT_PANIC=y
CONFIG_BOOTLOADER_WDT_ENABLE=y
CONFIG_LOG_DEFAULT_LEVEL_INFO=y
CONFIG_ZB_ENABLED=y
CONFIG_ZB_ZED=y
CONFIG_ZB_RADIO_NATIVE=y
```
