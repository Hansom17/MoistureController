## CMakeLists.txt
```
cmake_minimum_required(VERSION 3.20.0)
find_package(Zephyr REQUIRED HINTS $ENV{ZEPHYR_BASE})
project(mc_core_tests)

set(CORE ${CMAKE_CURRENT_LIST_DIR}/../../src/core)
file(GLOB CORE_SOURCES CONFIGURE_DEPENDS ${CORE}/*.c)
file(GLOB TEST_SOURCES CONFIGURE_DEPENDS src/*.c)
target_sources(app PRIVATE ${CORE_SOURCES} ${TEST_SOURCES})
target_include_directories(app PRIVATE ${CORE} ${CMAKE_CURRENT_BINARY_DIR})

# The contract's own examples (Gateway/specs.md) become test inputs.
find_package(Python3 REQUIRED)
execute_process(COMMAND ${Python3_EXECUTABLE}
    ${CMAKE_CURRENT_LIST_DIR}/../../../scripts/gen_contract_examples.py
    ${CMAKE_CURRENT_BINARY_DIR}/contract_examples.h
    COMMAND_ERROR_IS_FATAL ANY)
set_property(DIRECTORY APPEND PROPERTY CMAKE_CONFIGURE_DEPENDS
    ${CMAKE_CURRENT_LIST_DIR}/../../../../Gateway/specs.md
    ${CMAKE_CURRENT_LIST_DIR}/../../../scripts/gen_contract_examples.py)
```

## prj.conf
```kconfig
CONFIG_ZTEST=y
CONFIG_JSON_LIBRARY=y
CONFIG_CRC=y

CONFIG_MAIN_STACK_SIZE=4096
CONFIG_ZTEST_STACK_SIZE=8192
```

## src/test_ble.c
```c
/* The BLE pairing session against the frames the Python reference produced. */
#include <zephyr/ztest.h>
#include <string.h>
#include <zephyr/sys/crc.h>

#include "ble_vectors.h"
#include "mc_ble.h"

static struct mc_ble_session sess;

struct fake {
	char ssid[40], password[80], device_id[40], host[70];
	int port;
	uint8_t psk[32];
	int set_wifi, set_mqtt, commits, aborts;
};
static struct fake fk;

static int hex(const char *h, uint8_t *out, size_t cap)
{
	size_t n = strlen(h) / 2;

	zassert_true(n <= cap);
	for (size_t i = 0; i < n; i++) {
		unsigned v;

		sscanf(h + 2 * i, "%2x", &v);
		out[i] = (uint8_t)v;
	}
	return (int)n;
}

static int op_info(void *u, struct mc_ble_info *o)
{
	strcpy(o->hw_mac, "24:6F:28:AA:BB:CC");
	o->provisioned = false;
	return 0;
}
static int op_scan(void *u, struct mc_ble_net *o, size_t max)
{
	strcpy(o[0].ssid, "Home");
	o[0].rssi = -50;
	o[0].secure = true;
	strcpy(o[1].ssid, "Guest");
	o[1].rssi = -70;
	o[1].secure = false;
	return 2;
}
static int op_set_wifi(void *u, const char *ssid, const char *pw)
{
	strcpy(fk.ssid, ssid);
	strcpy(fk.password, pw);
	fk.set_wifi++;
	return 0;
}
static int op_set_mqtt(void *u, const char *id, const char *host, int port, const uint8_t psk[32])
{
	strcpy(fk.device_id, id);
	strcpy(fk.host, host);
	fk.port = port;
	memcpy(fk.psk, psk, 32);
	fk.set_mqtt++;
	return 0;
}
static int op_test(void *u, struct mc_ble_test *t)
{
	t->wifi_ok = true;
	t->mqtt_ok = false;
	strcpy(t->detail, "tls handshake failed");
	return 0;
}
static int op_commit(void *u)
{
	fk.commits++;
	return 0;
}
static void op_abort(void *u)
{
	fk.aborts++;
}

static const struct mc_ble_ops ops = {.info = op_info, .wifi_scan = op_scan, .set_wifi = op_set_wifi,
				      .set_mqtt = op_set_mqtt, .test = op_test, .commit = op_commit,
				      .abort = op_abort};

static uint8_t priv[32], nonce[16], pop[16];

static void start(const uint8_t *use_pop)
{
	memset(&fk, 0, sizeof(fk));
	hex(vec_pop, pop, sizeof(pop));
	hex(vec_device_private, priv, sizeof(priv));
	hex(vec_nonce_d, nonce, sizeof(nonce));
	mc_ble_init(&sess, use_pop ? use_pop : pop, &ops, NULL);
	sess.fixed_priv = priv;
	sess.fixed_nonce = nonce;
}

/* Feeds `n` bytes in pieces of `chunk` (0 = all at once). */
static int feed(const uint8_t *d, size_t n, size_t chunk)
{
	int rc = 0;

	for (size_t off = 0; off < n && rc == 0; off += chunk ? chunk : n) {
		rc = mc_ble_feed(&sess, d + off, MIN(chunk ? chunk : n, n - off));
	}
	return rc;
}

static size_t drain(uint8_t *out, size_t cap)
{
	size_t n = 0, got;

	while ((got = mc_ble_take(&sess, out + n, MIN(cap - n, (size_t)7))) > 0) {
		n += got; /* taken in odd-sized pieces on purpose */
	}
	return n;
}

/* Replays a scripted session: every app->dev frame in, the next dev->app frame must match. */
static void replay(const struct vframe *frames, size_t count, size_t chunk)
{
	static uint8_t in[1200], want[1200], got[1200];

	for (size_t i = 0; i < count; i++) {
		if (!frames[i].to_dev) {
			continue;
		}
		int n = hex(frames[i].hex, in, sizeof(in));

		zassert_equal(feed(in, n, chunk), 0, "frame %d rejected, fail=%d", (int)i, sess.fail);
		zassert_true(i + 1 < count && !frames[i + 1].to_dev);
		int wn = hex(frames[i + 1].hex, want, sizeof(want));
		size_t gn = drain(got, sizeof(got));

		zassert_equal(gn, (size_t)wn, "reply to frame %d: %d bytes, want %d", (int)i, (int)gn, wn);
		zassert_mem_equal(got, want, wn, "reply to frame %d differs", (int)i);
	}
}

ZTEST(ble, test_main_session_matches_the_reference_byte_for_byte)
{
	size_t chunks[] = {0, 185, 20, 1};

	for (size_t c = 0; c < ARRAY_SIZE(chunks); c++) {
		start(NULL);
		replay(vec_frames, VEC_FRAMES_N, chunks[c]);
		zassert_equal(sess.state, MC_BLE_OPEN);
		zassert_true(sess.commit_done);
		zassert_equal(fk.commits, 1);
	}
	/* what the device stored after the last run: escapes resolved, UTF-8 intact */
	zassert_str_equal(fk.ssid, "Home \"5G\"");
	zassert_str_equal(fk.password, "pa\\ss w\xC3\xB6rd");
	zassert_str_equal(fk.device_id, "mc-8f3kq2v7xw1m9hzt");
	zassert_str_equal(fk.host, "192.168.1.20");
	zassert_equal(fk.port, 8883);
	for (int i = 0; i < 32; i++) {
		zassert_equal(fk.psk[i], 0xab);
	}
	zassert_equal(fk.set_wifi, 1);
	zassert_equal(fk.set_mqtt, 1);
}

ZTEST(ble, test_ops_session_errors_and_results_match_the_reference)
{
	start(NULL);
	replay(vec_ops_frames, VEC_OPS_FRAMES_N, 0);
	zassert_equal(fk.aborts, 1);
	zassert_equal(fk.commits, 0, "commit after abort is refused");
	zassert_false(sess.commit_done);
	zassert_equal(fk.set_wifi, 1, "the empty ssid never reached the ops");
	zassert_equal(fk.set_mqtt, 1, "the bad key never reached the ops");
}

ZTEST(ble, test_wrong_pop_fails_the_confirmation)
{
	static uint8_t in[400];
	uint8_t other[16];

	memset(other, 0x42, sizeof(other));
	start(other);
	int n = hex(vec_frames[0].hex, in, sizeof(in));

	zassert_equal(feed(in, n, 0), 0);
	zassert_true(mc_ble_has_output(&sess)); /* a HELLO_ACK goes out either way */
	n = hex(vec_frames[2].hex, in, sizeof(in));
	zassert_true(feed(in, n, 0) < 0);
	zassert_equal(sess.fail, MC_BLE_FAIL_CONFIRM);
	zassert_equal(sess.state, MC_BLE_FAILED);
	/* the failed session is dead: nothing more is accepted */
	zassert_true(feed(in, n, 0) < 0);
}

static void open_session(void)
{
	static uint8_t in[400];

	start(NULL);
	for (int i = 0; i < 4; i++) {
		if (vec_frames[i].to_dev) {
			int n = hex(vec_frames[i].hex, in, sizeof(in));

			zassert_equal(feed(in, n, 0), 0);
		}
	}
	zassert_equal(sess.state, MC_BLE_OPEN);
	uint8_t drop[400];

	drain(drop, sizeof(drop));
}

ZTEST(ble, test_tampered_replayed_and_reordered_frames_end_the_session)
{
	static uint8_t f[1200];
	int n;

	open_session();
	n = hex(vec_frames[4].hex, f, sizeof(f));
	f[n - 1] ^= 1;
	zassert_true(feed(f, n, 0) < 0);
	zassert_equal(sess.fail, MC_BLE_FAIL_FRAME);

	open_session(); /* replay */
	n = hex(vec_frames[4].hex, f, sizeof(f));
	zassert_equal(feed(f, n, 0), 0);
	zassert_true(feed(f, n, 0) < 0);
	zassert_equal(sess.fail, MC_BLE_FAIL_FRAME);

	open_session(); /* reordering: the second request first */
	n = hex(vec_frames[6].hex, f, sizeof(f));
	zassert_true(feed(f, n, 0) < 0);
	zassert_equal(sess.fail, MC_BLE_FAIL_FRAME);
}

ZTEST(ble, test_a_frame_the_device_itself_sent_is_not_accepted_back)
{
	static uint8_t f[1200];

	open_session();
	int n = hex(vec_frames[5].hex, f, sizeof(f)); /* the device's own reply to `info` */

	zassert_true(feed(f, n, 0) < 0);
	zassert_equal(sess.fail, MC_BLE_FAIL_FRAME);
}

ZTEST(ble, test_unsupported_version_is_told_and_refused)
{
	static const char hello[] = "{\"t\":\"hello\",\"v\":2,\"pub\":\"AAAA\"}";
	uint8_t f[80], out[120];
	size_t n = strlen(hello);

	start(NULL);
	f[0] = 0;
	f[1] = (uint8_t)n;
	memcpy(f + 2, hello, n);
	zassert_true(feed(f, n + 2, 0) < 0);
	zassert_equal(sess.fail, MC_BLE_FAIL_VERSION);
	size_t got = drain(out, sizeof(out));

	zassert_true(got > 2);
	out[got] = '\0';
	zassert_not_null(strstr((char *)out + 2, "unsupported_version"));
}

ZTEST(ble, test_garbage_before_the_handshake)
{
	static const uint8_t junk[] = {0x00, 0x05, 'h', 'e', 'l', 'l', 'o'};
	static const uint8_t huge[] = {0xff, 0xff};

	start(NULL);
	zassert_true(feed(junk, sizeof(junk), 0) < 0);
	zassert_equal(sess.fail, MC_BLE_FAIL_PROTOCOL);
	start(NULL);
	zassert_true(feed(huge, sizeof(huge), 0) < 0);
	zassert_equal(sess.fail, MC_BLE_FAIL_FRAME);
	/* a confirm before any hello */
	static const char c[] = "{\"t\":\"confirm\",\"mac\":\"AAAA\"}";
	uint8_t f[60];

	start(NULL);
	f[0] = 0;
	f[1] = strlen(c);
	memcpy(f + 2, c, strlen(c));
	zassert_true(feed(f, strlen(c) + 2, 0) < 0);
}

ZTEST(ble, test_keys_are_wiped_on_close)
{
	open_session();
	mc_ble_close(&sess);
	uint8_t zero[16] = {0};

	zassert_mem_equal(sess.k_enc, zero, 16);
	zassert_mem_equal(sess.k_mac, zero, 16);
	zassert_mem_equal(sess.pop, zero, 16);
}

ZTEST(ble, test_random_keys_work_too_and_differ_per_session)
{
	/* production path: no fixed key or nonce */
	static uint8_t in[400], a[100], b[100];

	start(NULL);
	sess.fixed_priv = NULL;
	sess.fixed_nonce = NULL;
	int n = hex(vec_frames[0].hex, in, sizeof(in));

	zassert_equal(feed(in, n, 0), 0);
	size_t na = drain(a, sizeof(a));

	start(NULL);
	sess.fixed_priv = NULL;
	sess.fixed_nonce = NULL;
	zassert_equal(feed(in, n, 0), 0);
	size_t nb = drain(b, sizeof(b));

	zassert_true(na > 0 && na == nb);
	zassert_true(memcmp(a, b, na) != 0, "two sessions answered identically");
}

ZTEST(ble, test_factory_page)
{
	uint8_t page[MC_FACTORY_SIZE] = {'M', 'C', 'F', 'P', 1};
	uint8_t out[16];

	for (int i = 0; i < 16; i++) {
		page[5 + i] = (uint8_t)(0xA0 + i);
	}
	uint32_t crc = crc32_ieee(page, 21);

	page[21] = crc;
	page[22] = crc >> 8;
	page[23] = crc >> 16;
	page[24] = crc >> 24;
	zassert_true(mc_factory_parse(page, out));
	zassert_equal(out[0], 0xA0);
	zassert_equal(out[15], 0xAF);
	page[10] ^= 1;
	zassert_false(mc_factory_parse(page, out)); /* CRC */
	page[10] ^= 1;
	page[4] = 2;
	zassert_false(mc_factory_parse(page, out)); /* version */
	memset(page, 0xff, sizeof(page));
	zassert_false(mc_factory_parse(page, out)); /* erased flash */

	/* the page the Python tool writes (same CRC, same layout) */
	hex(vec_factory_page, page, sizeof(page));
	zassert_true(mc_factory_parse(page, out));
	zassert_equal(out[0], 0x00);
	zassert_equal(out[15], 0x0f);
}

ZTEST_SUITE(ble, NULL, NULL, NULL, NULL, NULL);
```

## src/test_cmd.c
```c
#include <zephyr/ztest.h>
#include <string.h>

#include "contract_examples.h"
#include "mc_cmd.h"

#define NOW 1790412000

static struct mc_config cfg;
static struct mc_cmd_hist hist;
static struct mc_ctx ctx;

static void before(void *f)
{
	struct mc_error e;
	char doc[] = "{\"rev\":1,\"wake_interval_s\":600,\"slots\":["
		     "{\"slot\":0,\"module\":\"moisture_capacitive\",\"pin\":34},"
		     "{\"slot\":2,\"module\":\"pump_relay\",\"pin\":25,\"max_run_s\":60,"
		     "\"min_pause_s\":600}]}";

	zassert_true(mc_config_parse(doc, strlen(doc), &cfg, &e));
	zassert_true(mc_config_validate(&cfg, &e));
	mc_hist_init(&hist);
	memset(&ctx, 0, sizeof(ctx));
	ctx.cfg = &cfg;
	ctx.now = NOW;
	ctx.time_synced = true;
	ctx.hist = &hist;
}

static bool parse(const char *json, struct mc_cmd *c)
{
	char buf[256];

	strncpy(buf, json, sizeof(buf) - 1);
	buf[sizeof(buf) - 1] = '\0';
	return mc_cmd_parse(buf, strlen(buf), c);
}

static struct mc_outcome decide(const char *json)
{
	struct mc_cmd c;
	struct mc_outcome o;

	zassert_true(parse(json, &c), "%s", json);
	mc_cmd_decide(&ctx, &c, &o);
	return o;
}

#define CMD(id, action, exp, args) \
	"{\"id\":\"" id "\",\"action\":\"" action "\",\"exp\":" #exp ",\"args\":{" args "}}"

ZTEST(cmd, test_contract_example_parses)
{
	struct mc_cmd c;

	zassert_true(EXAMPLE_CMDS_N >= 1);
	zassert_true(parse(example_cmds[0], &c));
	zassert_str_equal(c.id, "01J8ZQ6H7K2M4N5P6Q7R8S9T0V");
	zassert_equal(c.action, MC_ACT_PUMP_RUN);
	zassert_equal(c.exp, 1790414100);
	zassert_equal(c.slot, 2);
	zassert_equal(c.seconds, 10);
	zassert_equal(c.minutes, -1);
}

ZTEST(cmd, test_parse_rejects_what_cannot_be_acknowledged)
{
	struct mc_cmd c;

	zassert_false(parse("{\"action\":\"pump.run\",\"exp\":1}", &c));           /* no id */
	zassert_false(parse("{\"id\":\"\",\"action\":\"pump.run\"}", &c));
	zassert_false(parse("{\"id\":\"01234567890123456789012345X\",\"action\":\"x\"}", &c));
	zassert_false(parse("garbage", &c));
	zassert_true(parse("{\"id\":\"A\",\"action\":\"pump.fly\",\"exp\":1}", &c));
	zassert_equal(c.action, MC_ACT_UNKNOWN);
	zassert_true(parse("{\"id\":\"A\",\"exp\":1}", &c)); /* missing action: unknown, not a crash */
	zassert_equal(c.action, MC_ACT_UNKNOWN);
}

ZTEST(cmd, test_accepts_a_valid_run)
{
	struct mc_outcome o = decide(CMD("A", "pump.run", 1790414100, "\"slot\":2,\"seconds\":10"));

	zassert_equal(o.ack.status, MC_ACK_DONE);
	zassert_equal(o.action, MC_DO_PUMP_RUN);
	zassert_equal(o.slot, 2);
	zassert_equal(o.value, 10);
	zassert_equal(o.ack.ts, NOW);
}

ZTEST(cmd, test_rejections)
{
	struct { const char *json; const char *reason; } t[] = {
		{CMD("A", "pump.run", 1790411999, "\"slot\":2,\"seconds\":10"), "expired"},
		{CMD("A", "pump.run", 1790414100, "\"seconds\":10"), "invalid_args"},
		{CMD("A", "pump.run", 1790414100, "\"slot\":2"), "invalid_args"},
		{CMD("A", "pump.run", 1790414100, "\"slot\":0,\"seconds\":10"), "slot_not_actuator"},
		{CMD("A", "pump.run", 1790414100, "\"slot\":5,\"seconds\":10"), "slot_not_actuator"},
		{CMD("A", "pump.run", 1790414100, "\"slot\":2,\"seconds\":61"), "safety_limit"},
		{CMD("A", "pump.run", 1790414100, "\"slot\":2,\"seconds\":0"), "safety_limit"},
		{CMD("A", "pump.fly", 1790414100, ""), "unknown_action"},
		{CMD("A", "pump.stop", 1790414100, "\"slot\":0"), "slot_not_actuator"},
		{CMD("A", "pump.stop", 1790414100, ""), "invalid_args"},
	};

	for (size_t i = 0; i < ARRAY_SIZE(t); i++) {
		struct mc_outcome o = decide(t[i].json);

		zassert_equal(o.ack.status, MC_ACK_REJECTED, "%s", t[i].json);
		zassert_str_equal(o.ack.reason, t[i].reason, "%s", t[i].json);
		zassert_equal(o.action, MC_DO_NONE);
	}
}

ZTEST(cmd, test_expiry_boundary_is_inclusive)
{
	struct mc_outcome o = decide(CMD("A", "pump.run", 1790412000, "\"slot\":2,\"seconds\":5"));

	zassert_equal(o.ack.status, MC_ACK_DONE); /* exp == now still runs */
}

ZTEST(cmd, test_no_clock_means_no_watering)
{
	ctx.time_synced = false;
	struct mc_outcome o = decide(CMD("A", "pump.run", 1790414100, "\"slot\":2,\"seconds\":5"));

	zassert_equal(o.ack.status, MC_ACK_REJECTED);
	zassert_str_equal(o.ack.reason, "no_time");
	o = decide(CMD("B", "device.identify", 1790414100, ""));
	zassert_str_equal(o.ack.reason, "no_time");
	/* switching off never waits for a clock */
	o = decide(CMD("C", "pump.stop", 1790414100, "\"slot\":2"));
	zassert_equal(o.ack.status, MC_ACK_DONE);
	zassert_equal(o.action, MC_DO_PUMP_STOP);
	zassert_equal(o.ack.ts, 0); /* no timestamp without a clock */
}

ZTEST(cmd, test_min_pause_and_busy)
{
	ctx.pump[2].last_end = NOW - 100; /* ended 100 s ago, pause is 600 s */
	struct mc_outcome o = decide(CMD("A", "pump.run", 1790414100, "\"slot\":2,\"seconds\":5"));

	zassert_str_equal(o.ack.reason, "safety_limit");
	ctx.pump[2].last_end = NOW - 600;
	o = decide(CMD("A", "pump.run", 1790414100, "\"slot\":2,\"seconds\":5"));
	zassert_equal(o.ack.status, MC_ACK_DONE);

	ctx.pump[2].last_end = 0;
	mc_pump_begin_hold(&ctx.pump[2], "HELD", NOW + 120);
	o = decide(CMD("B", "pump.run", 1790414100, "\"slot\":2,\"seconds\":5"));
	zassert_str_equal(o.ack.reason, "busy");
}

ZTEST(cmd, test_misc_actions_and_clamping)
{
	struct mc_outcome o = decide(CMD("A", "device.identify", 1790414100, ""));

	zassert_equal(o.action, MC_DO_IDENTIFY);
	zassert_equal(o.value, 10);
	o = decide(CMD("B", "device.identify", 1790414100, "\"seconds\":500"));
	zassert_equal(o.value, 60);
	o = decide(CMD("C", "device.service", 1790414100, "\"minutes\":99"));
	zassert_equal(o.action, MC_DO_SERVICE);
	zassert_equal(o.value, 30);
	o = decide(CMD("D", "device.service", 1790414100, ""));
	zassert_equal(o.value, 15);
	o = decide(CMD("E", "device.reboot", 1790414100, ""));
	zassert_equal(o.action, MC_DO_REBOOT);
}

ZTEST(cmd, test_duplicates_are_answered_again_not_executed)
{
	struct mc_cmd c;
	struct mc_outcome o;
	struct mc_ack running = {.id = "A", .status = MC_ACK_RUNNING, .ends_at = NOW + 100};

	zassert_true(parse(CMD("A", "pump.run", 1790414100, "\"slot\":2,\"seconds\":5"), &c));
	mc_hist_put(&hist, "A", &running);
	mc_cmd_decide(&ctx, &c, &o);
	zassert_true(o.duplicate);
	zassert_equal(o.action, MC_DO_NONE);
	zassert_equal(o.ack.status, MC_ACK_RUNNING);
	zassert_equal(o.ack.ends_at, NOW + 100);
}

ZTEST(cmd, test_history_keeps_the_last_16)
{
	struct mc_ack a = {.status = MC_ACK_DONE};
	char id[8];

	for (int i = 1; i <= 20; i++) {
		snprintk(id, sizeof(id), "C%d", i);
		mc_hist_put(&hist, id, &a);
	}
	zassert_is_null(mc_hist_find(&hist, "C1"));
	zassert_is_null(mc_hist_find(&hist, "C4"));
	zassert_not_null(mc_hist_find(&hist, "C5"));
	zassert_not_null(mc_hist_find(&hist, "C20"));
	/* updating an existing id does not evict another */
	a.status = MC_ACK_REJECTED;
	mc_hist_put(&hist, "C5", &a);
	zassert_not_null(mc_hist_find(&hist, "C6"));
	zassert_equal(mc_hist_find(&hist, "C5")->status, MC_ACK_REJECTED);
}

/* --- batches ------------------------------------------------------------------------------------ */

struct log {
	int n;
	char id[8][MC_ID_LEN + 1];
	enum mc_ack_status status[8];
	enum mc_do_kind action[8];
	char reason[8][20];
};

static void exec(struct mc_ctx *c, const struct mc_cmd *cmd, struct mc_outcome *out, void *user)
{
	struct log *l = user;

	strcpy(l->id[l->n], out->ack.id);
	l->status[l->n] = out->ack.status;
	l->action[l->n] = out->action;
	strcpy(l->reason[l->n], out->ack.reason);
	l->n++;
	if (out->action == MC_DO_PUMP_RUN) { /* what the app does for a short run */
		mc_pump_finish(&c->pump[out->slot], c->now);
	}
}

static struct log run_batch(const char *const *json, size_t n)
{
	struct mc_cmd cmds[MC_CMD_BATCH_MAX];
	struct log l = {0};

	for (size_t i = 0; i < n; i++) {
		zassert_true(parse(json[i], &cmds[i]));
	}
	mc_cmd_process(&ctx, cmds, n, exec, &l);
	return l;
}

ZTEST(cmd, test_cancel_wins_over_a_command_in_the_same_batch)
{
	const char *b[] = {
		CMD("RUN", "pump.run", 1790414100, "\"slot\":2,\"seconds\":10"),
		CMD("CXL", "cmd.cancel", 1790414100, "\"target\":\"RUN\""),
	};
	struct log l = run_batch(b, 2);

	zassert_equal(l.n, 2);
	zassert_str_equal(l.id[0], "RUN");
	zassert_equal(l.status[0], MC_ACK_CANCELLED);
	zassert_equal(l.action[0], MC_DO_NONE); /* the pump never ran */
	zassert_str_equal(l.id[1], "CXL");
	zassert_equal(l.status[1], MC_ACK_DONE);
	zassert_equal(ctx.pump[2].last_end, 0);
}

ZTEST(cmd, test_cancel_arriving_first_also_works)
{
	const char *b[] = {
		CMD("CXL", "cmd.cancel", 1790414100, "\"target\":\"RUN\""),
		CMD("RUN", "pump.run", 1790414100, "\"slot\":2,\"seconds\":10"),
	};
	struct log l = run_batch(b, 2);

	zassert_equal(l.status[0], MC_ACK_DONE);
	zassert_equal(l.status[1], MC_ACK_CANCELLED);
	zassert_equal(l.action[1], MC_DO_NONE);
}

ZTEST(cmd, test_cancel_after_the_run_is_already_done)
{
	const char *b1[] = {CMD("RUN", "pump.run", 1790414100, "\"slot\":2,\"seconds\":10")};
	const char *b2[] = {CMD("CXL", "cmd.cancel", 1790414100, "\"target\":\"RUN\"")};
	struct log l = run_batch(b1, 1);

	zassert_equal(l.status[0], MC_ACK_DONE);
	l = run_batch(b2, 1);
	zassert_equal(l.status[0], MC_ACK_REJECTED);
	zassert_str_equal(l.reason[0], "already_done");
}

ZTEST(cmd, test_cancel_for_a_command_not_seen_yet_leaves_a_tombstone)
{
	const char *b1[] = {CMD("CXL", "cmd.cancel", 1790414100, "\"target\":\"LATER\"")};
	const char *b2[] = {CMD("LATER", "pump.run", 1790414100, "\"slot\":2,\"seconds\":10")};
	struct log l = run_batch(b1, 1);

	zassert_equal(l.status[0], MC_ACK_DONE);
	l = run_batch(b2, 1);
	zassert_equal(l.n, 1);
	zassert_equal(l.status[0], MC_ACK_CANCELLED);
	zassert_equal(l.action[0], MC_DO_NONE);
}

ZTEST(cmd, test_a_redelivered_batch_is_not_executed_twice)
{
	const char *b[] = {CMD("RUN", "pump.run", 1790414100, "\"slot\":2,\"seconds\":10"),
			   CMD("ID", "device.identify", 1790414100, "")};
	struct log l = run_batch(b, 2);

	zassert_equal(l.action[0], MC_DO_PUMP_RUN);
	ctx.pump[2].last_end = 0; /* would otherwise trip the safety pause */
	l = run_batch(b, 2);
	zassert_equal(l.n, 2);
	zassert_equal(l.action[0], MC_DO_NONE);
	zassert_equal(l.action[1], MC_DO_NONE);
	zassert_equal(l.status[0], MC_ACK_DONE); /* same answer again */
}

ZTEST(cmd, test_commands_run_in_order_and_the_pause_applies_between_them)
{
	const char *b[] = {CMD("R1", "pump.run", 1790414100, "\"slot\":2,\"seconds\":5"),
			   CMD("R2", "pump.run", 1790414100, "\"slot\":2,\"seconds\":5")};
	struct log l = run_batch(b, 2);

	zassert_equal(l.status[0], MC_ACK_DONE);
	zassert_equal(l.status[1], MC_ACK_REJECTED); /* min_pause_s 600 after the first */
	zassert_str_equal(l.reason[1], "safety_limit");
}

/* --- pump holds through sleep ---------------------------------------------------------------------- */

ZTEST(cmd, test_long_run_hold_lifecycle)
{
	zassert_false(mc_pump_run_is_inline(MC_PUMP_INLINE_MAX_S + 1));
	zassert_true(mc_pump_run_is_inline(MC_PUMP_INLINE_MAX_S));
	zassert_equal(mc_pump_due_stop(&ctx), -1);
	zassert_equal(mc_pump_next_stop_in(&ctx), -1);

	mc_pump_begin_hold(&ctx.pump[2], "LONG", NOW + 300);
	zassert_equal(mc_pump_due_stop(&ctx), -1);
	zassert_equal(mc_pump_next_stop_in(&ctx), 300);

	ctx.now = NOW + 300; /* woke up at the end */
	zassert_equal(mc_pump_due_stop(&ctx), 2);
	struct mc_ack ack;

	zassert_true(mc_pump_end_hold(&ctx.pump[2], ctx.now, MC_ACK_DONE, &ack));
	zassert_str_equal(ack.id, "LONG");
	zassert_equal(ack.status, MC_ACK_DONE);
	zassert_equal(ack.ts, NOW + 300);
	zassert_equal(mc_pump_due_stop(&ctx), -1);
	zassert_equal(ctx.pump[2].last_end, NOW + 300);
	zassert_false(mc_pump_end_hold(&ctx.pump[2], ctx.now, MC_ACK_DONE, &ack)); /* nothing left */
}

ZTEST(cmd, test_stopping_a_held_run_cancels_its_command)
{
	struct mc_ack ack;

	mc_pump_begin_hold(&ctx.pump[2], "LONG", NOW + 300);
	zassert_true(mc_pump_end_hold(&ctx.pump[2], ctx.now, MC_ACK_CANCELLED, &ack));
	zassert_equal(ack.status, MC_ACK_CANCELLED);
	zassert_equal(ack.ts, 0);
}

ZTEST_SUITE(cmd, NULL, NULL, before, NULL, NULL);
```

## src/test_config.c
```c
#include <zephyr/ztest.h>
#include <string.h>

#include "contract_examples.h"
#include "mc_config.h"

static bool parse(const char *json, struct mc_config *c, struct mc_error *e)
{
	char buf[1024];

	strncpy(buf, json, sizeof(buf) - 1);
	buf[sizeof(buf) - 1] = '\0';
	return mc_config_parse(buf, strlen(buf), c, e);
}

/* Parses and validates; returns the error code or NULL if the config is valid. */
static const char *verdict(const char *json, struct mc_error *e)
{
	struct mc_config c;

	if (!parse(json, &c, e)) {
		return e->code;
	}
	return mc_config_validate(&c, e) ? NULL : e->code;
}

ZTEST(config, test_contract_example_parses_and_is_valid)
{
	struct mc_config c;
	struct mc_error e;

	zassert_true(EXAMPLE_DESIRED_N >= 1);
	for (int i = 0; i < EXAMPLE_DESIRED_N; i++) {
		zassert_true(parse(example_desired[i], &c, &e), "parse: %s", e.detail);
		zassert_true(mc_config_validate(&c, &e), "%s: %s", e.code, e.detail);
	}
	zassert_true(parse(example_desired[0], &c, &e));
	zassert_equal(c.rev, 8);
	zassert_equal(c.wake_interval_s, 600);
	zassert_equal(c.n, 4);
	zassert_equal(c.slots[0].module, MC_MOD_MOISTURE_CAPACITIVE);
	zassert_equal(c.slots[0].pin, 34);
	zassert_equal(c.slots[1].cal_dry, 3050);
	zassert_equal(c.slots[2].module, MC_MOD_PUMP_RELAY);
	zassert_true(c.slots[2].active_high);
	zassert_equal(c.slots[2].max_run_s, 60);
	zassert_equal(c.slots[2].min_pause_s, 600);
	zassert_equal(c.slots[3].module, MC_MOD_DS18B20);
}

ZTEST(config, test_defaults_for_optional_fields)
{
	struct mc_config c;
	struct mc_error e;

	zassert_true(parse("{\"rev\":1,\"wake_interval_s\":900,\"slots\":["
			   "{\"slot\":0,\"module\":\"moisture_capacitive\",\"pin\":34},"
			   "{\"slot\":2,\"module\":\"pump_relay\",\"pin\":25,\"max_run_s\":10}]}",
			   &c, &e));
	zassert_equal(c.slots[0].cal_dry, MC_CAL_DRY_DEFAULT);
	zassert_equal(c.slots[0].cal_wet, MC_CAL_WET_DEFAULT);
	zassert_equal(c.slots[1].min_pause_s, 0);
	zassert_true(c.slots[1].active_high);
	zassert_true(mc_config_validate(&c, &e));
}

ZTEST(config, test_unknown_fields_are_ignored)
{
	struct mc_error e;

	zassert_is_null(verdict("{\"rev\":1,\"wake_interval_s\":600,\"future\":[1,2,{\"a\":1}],"
				"\"slots\":[{\"slot\":0,\"module\":\"moisture_capacitive\","
				"\"pin\":34,\"color\":\"red\"}]}", &e));
}

#define SLOT(module, pin, extra) "{\"slot\":0,\"module\":\"" module "\",\"pin\":" #pin extra "}"
#define DOC(slots) "{\"rev\":2,\"wake_interval_s\":600,\"slots\":[" slots "]}"

ZTEST(config, test_pin_rules)
{
	struct mc_error e;

	/* outputs on input-only pins */
	zassert_str_equal(verdict(DOC(SLOT("pump_relay", 34, ",\"max_run_s\":10")), &e),
			  "pin_not_output");
	zassert_equal(e.slot, 0);
	zassert_not_null(strstr(e.detail, "GPIO 34"));
	/* reserved: flash, UART, LED, BOOT */
	for (int pin = 0; pin < 40; pin++) {
		bool reserved = pin <= 3 || (pin >= 6 && pin <= 11);
		char doc[160];

		snprintk(doc, sizeof(doc), DOC("{\"slot\":0,\"module\":\"moisture_capacitive\","
					       "\"pin\":%d}"), pin);
		const char *v = verdict(doc, &e);

		if (reserved) {
			zassert_str_equal(v, "pin_reserved", "pin %d", pin);
		}
	}
	/* a moisture sensor on a pin without ADC */
	zassert_str_equal(verdict(DOC(SLOT("moisture_capacitive", 5, "")), &e), "out_of_range");
	/* pin beyond the GPIO range */
	zassert_str_equal(verdict(DOC(SLOT("moisture_capacitive", 99, "")), &e), "out_of_range");
	/* ADC1 and ADC2 pins are fine for sensors */
	zassert_is_null(verdict(DOC(SLOT("moisture_capacitive", 32, "")), &e));
	zassert_is_null(verdict(DOC(SLOT("moisture_capacitive", 15, "")), &e));
}

ZTEST(config, test_conflicts_and_slot_indexes)
{
	struct mc_error e;

	zassert_str_equal(verdict(DOC("{\"slot\":0,\"module\":\"moisture_capacitive\",\"pin\":34},"
				      "{\"slot\":1,\"module\":\"moisture_capacitive\",\"pin\":34}"),
				  &e), "pin_conflict");
	zassert_equal(e.slot, 1);
	zassert_not_null(strstr(e.detail, "slot 0"));
	zassert_str_equal(verdict(DOC("{\"slot\":0,\"module\":\"moisture_capacitive\",\"pin\":34},"
				      "{\"slot\":0,\"module\":\"moisture_capacitive\",\"pin\":35}"),
				  &e), "out_of_range");
	zassert_str_equal(verdict(DOC("{\"slot\":6,\"module\":\"moisture_capacitive\",\"pin\":34}"),
				  &e), "out_of_range");
}

ZTEST(config, test_modules_and_actuator_limits)
{
	struct mc_error e;

	zassert_str_equal(verdict(DOC(SLOT("laser", 25, "")), &e), "unknown_module");
	zassert_str_equal(verdict(DOC(SLOT("pump_relay", 25, "")), &e), "out_of_range"); /* no max_run_s */
	zassert_str_equal(verdict(DOC(SLOT("pump_relay", 25, ",\"max_run_s\":301")), &e),
			  "out_of_range");
	zassert_is_null(verdict(DOC(SLOT("pump_relay", 25, ",\"max_run_s\":300")), &e));
	zassert_str_equal(verdict(DOC(SLOT("moisture_capacitive", 34,
					   ",\"cal\":{\"dry\":1000,\"wet\":1000}")), &e),
			  "out_of_range");
	zassert_str_equal(verdict(DOC("{\"slot\":0,\"module\":\"sht3x\"}"), &e), "out_of_range");
	zassert_is_null(verdict(DOC("{\"slot\":0,\"module\":\"sht3x\",\"addr\":68}"), &e));
	zassert_str_equal(verdict(DOC("{\"slot\":0,\"module\":\"sht3x\",\"addr\":2}"), &e),
			  "out_of_range");
}

ZTEST(config, test_factory_default_never_sleeps)
{
	struct mc_config c;

	mc_config_init(&c);
	zassert_equal(c.wake_interval_s, 0);
	zassert_equal(c.awake_s, 0);
	zassert_true(mc_config_validate(&c, NULL));
}

ZTEST(config, test_awake_s)
{
	struct mc_config c;
	struct mc_error e;

	zassert_true(parse("{\"rev\":1,\"wake_interval_s\":600,\"slots\":[]}", &c, &e));
	zassert_equal(c.awake_s, 0, "absent = 0");
	zassert_true(parse("{\"rev\":1,\"wake_interval_s\":600,\"awake_s\":90,\"slots\":[]}", &c, &e));
	zassert_equal(c.awake_s, 90);
	zassert_is_null(verdict("{\"rev\":1,\"wake_interval_s\":600,\"awake_s\":3600,\"slots\":[]}", &e));
	zassert_str_equal(verdict("{\"rev\":1,\"wake_interval_s\":600,\"awake_s\":3601,\"slots\":[]}", &e),
			  "out_of_range");
	zassert_str_equal(verdict("{\"rev\":1,\"wake_interval_s\":600,\"awake_s\":-1,\"slots\":[]}", &e),
			  "out_of_range");
}

ZTEST(config, test_stored_v1_config_is_upgraded)
{
	static struct mc_config_v1 old;
	struct mc_config c;
	struct mc_error e;
	char doc[] = "{\"rev\":5,\"wake_interval_s\":900,\"slots\":["
		     "{\"slot\":0,\"module\":\"moisture_capacitive\",\"pin\":34,"
		     "\"cal\":{\"dry\":3100,\"wet\":1300}}]}";

	zassert_true(mc_config_parse(doc, strlen(doc), &c, &e));
	old.rev = c.rev;
	old.wake_interval_s = c.wake_interval_s;
	old.n = c.n;
	memcpy(old.slots, c.slots, sizeof(old.slots));

	struct mc_config up;

	zassert_true(mc_config_from_v1(&old, &up));
	zassert_equal(up.rev, 5);
	zassert_equal(up.wake_interval_s, 900);
	zassert_equal(up.awake_s, 0);
	zassert_equal(up.n, 1);
	zassert_equal(up.slots[0].cal_dry, 3100);
	zassert_true(mc_config_same(&c, &up));
	old.n = MC_SLOTS_MAX + 1;
	zassert_false(mc_config_from_v1(&old, &up));
}

ZTEST(config, test_document_level_limits)
{
	struct mc_error e;

	zassert_str_equal(verdict("{\"rev\":1,\"wake_interval_s\":59,\"slots\":[]}", &e),
			  "out_of_range");
	zassert_str_equal(verdict("{\"rev\":1,\"wake_interval_s\":86401,\"slots\":[]}", &e),
			  "out_of_range");
	zassert_is_null(verdict("{\"rev\":1,\"wake_interval_s\":60,\"slots\":[]}", &e));
	zassert_is_null(verdict("{\"rev\":1,\"wake_interval_s\":0,\"slots\":[]}", &e)); /* never sleep */
	zassert_str_equal(verdict("{\"rev\":1,\"wake_interval_s\":-1,\"slots\":[]}", &e),
			  "out_of_range");
	zassert_str_equal(verdict("{\"wake_interval_s\":600,\"slots\":[]}", &e), "out_of_range");
	zassert_str_equal(verdict("{\"rev\":1,\"slots\":[]}", &e), "out_of_range");
	zassert_str_equal(verdict("{not json", &e), "out_of_range");
	zassert_str_equal(verdict("", &e), "out_of_range");
	/* seven slots do not fit the table */
	zassert_str_equal(verdict(DOC("{\"slot\":0},{\"slot\":1},{\"slot\":2},{\"slot\":3},"
				      "{\"slot\":4},{\"slot\":5},{\"slot\":6}"), &e), "out_of_range");
	zassert_not_null(strstr(e.detail, "at most 6"));
}

ZTEST(config, test_write_roundtrip)
{
	struct mc_config a, b;
	struct mc_error e;
	char out[768];
	struct mc_jw w;

	zassert_true(parse(example_desired[0], &a, &e));
	mc_jw_init(&w, out, sizeof(out));
	mc_jw_obj(&w);
	mc_config_write(&w, &a);
	mc_jw_end_obj(&w);
	zassert_true(mc_jw_finish(&w) > 0);
	zassert_true(parse(out, &b, &e), "%s", out);
	zassert_equal(b.rev, 8);
	zassert_true(mc_config_same(&a, &b));
	b.slots[2].max_run_s = 61;
	zassert_false(mc_config_same(&a, &b));
}

ZTEST_SUITE(config, NULL, NULL, NULL, NULL, NULL);
```

## src/test_payload.c
```c
#include <zephyr/ztest.h>
#include <string.h>

#include "mc_payload.h"

#define CAP 600

ZTEST(payload, test_status_messages)
{
	char b[128];

	zassert_true(mc_enc_status_online(b, sizeof(b), 5521) > 0);
	zassert_str_equal(b, "{\"state\":\"online\",\"fw\":\"" MC_FW_VERSION "\",\"boot\":5521}");
	zassert_true(mc_enc_status_sleeping(b, sizeof(b), 600) > 0);
	zassert_str_equal(b, "{\"state\":\"sleeping\",\"next_wake_s\":600}");
	zassert_true(mc_enc_status_offline(b, sizeof(b)) > 0);
	zassert_str_equal(b, "{\"state\":\"offline\"}");
	zassert_true(mc_enc_status_service(b, sizeof(b), 900) > 0);
	zassert_str_equal(b, "{\"state\":\"service\",\"until_s\":900}");
}

ZTEST(payload, test_telemetry_matches_contract_example)
{
	/* mqtt.md §4.2: two soil sensors (one without signal) and a temperature. */
	struct mc_tel t = {
		.seq = 18422, .ts = 1790412305, .cfg_rev = 8, .n = 3,
		.r = {
			{.slot = 0, .type = MC_TYPE_SOIL_MOISTURE, .has_value = true,
			 .value_x10 = 415, .has_raw = true, .raw = 2143},
			{.slot = 1, .type = MC_TYPE_SOIL_MOISTURE, .err = MC_SENSOR_NO_SIGNAL,
			 .has_raw = true, .raw = 4095},
			{.slot = 3, .type = MC_TYPE_TEMPERATURE, .has_value = true, .value_x10 = 213},
		},
		.h = {.batt_mv = 3910, .rssi = -67, .wake = MC_WAKE_TIMER, .cycle_ms = 2140,
		      .wifi_ms = 1450},
	};
	char b[CAP];

	zassert_true(mc_enc_telemetry(b, sizeof(b), &t) > 0);
	zassert_str_equal(b,
		"{\"seq\":18422,\"ts\":1790412305,\"cfg_rev\":8,\"readings\":["
		"{\"slot\":0,\"type\":\"soil_moisture\",\"value\":41.5,\"unit\":\"%\",\"raw\":2143},"
		"{\"slot\":1,\"type\":\"soil_moisture\",\"error\":\"no_signal\",\"raw\":4095},"
		"{\"slot\":3,\"type\":\"temperature\",\"value\":21.3,\"unit\":\"\xC2\xB0" "C\"}],"
		"\"health\":{\"batt_mv\":3910,\"rssi\":-67,\"wake\":\"timer\",\"cycle_ms\":2140,"
		"\"wifi_ms\":1450}}");
}

ZTEST(payload, test_telemetry_omits_unknown_fields)
{
	struct mc_tel t = {.seq = 1, .ts = 0, .cfg_rev = 0, .n = 0,
			   .h = {.batt_mv = 3700, .rssi = -80, .wake = MC_WAKE_POWER_ON,
				 .cycle_ms = -1, .wifi_ms = -1}};
	char b[CAP];

	zassert_true(mc_enc_telemetry(b, sizeof(b), &t) > 0);
	zassert_str_equal(b, "{\"seq\":1,\"cfg_rev\":0,\"readings\":[],"
			     "\"health\":{\"batt_mv\":3700,\"rssi\":-80,\"wake\":\"power_on\"}}");
}

ZTEST(payload, test_events)
{
	struct mc_event e = {.seq = 18423, .ts = 1790412306, .kind = MC_EV_SAFETY_STOP, .slot = 2,
			     .detail = "max_run_s reached"};
	char b[CAP];

	zassert_true(mc_enc_event(b, sizeof(b), &e) > 0);
	zassert_str_equal(b, "{\"seq\":18423,\"ts\":1790412306,\"kind\":\"safety_stop\",\"slot\":2,"
			     "\"detail\":\"max_run_s reached\"}");
	e = (struct mc_event){.seq = 9, .kind = MC_EV_BOOT, .slot = -1};
	zassert_true(mc_enc_event(b, sizeof(b), &e) > 0);
	zassert_str_equal(b, "{\"seq\":9,\"kind\":\"boot\"}");
}

ZTEST(payload, test_acks_match_contract_examples)
{
	char b[CAP];
	struct mc_ack a = {.id = "01J8ZQ6H7K2M4N5P6Q7R8S9T0V", .status = MC_ACK_DONE,
			   .ts = 1790412318};

	zassert_true(mc_enc_ack(b, sizeof(b), &a) > 0);
	zassert_str_equal(b, "{\"id\":\"01J8ZQ6H7K2M4N5P6Q7R8S9T0V\",\"status\":\"done\","
			     "\"ts\":1790412318}");
	a = (struct mc_ack){.id = "01J8ZQ6H7K2M4N5P6Q7R8S9T0V", .status = MC_ACK_RUNNING,
			    .ends_at = 1790413500};
	zassert_true(mc_enc_ack(b, sizeof(b), &a) > 0);
	zassert_str_equal(b, "{\"id\":\"01J8ZQ6H7K2M4N5P6Q7R8S9T0V\",\"status\":\"running\","
			     "\"ends_at\":1790413500}");
	a = (struct mc_ack){.id = "01J8ZQ6H7K2M4N5P6Q7R8S9T0V", .status = MC_ACK_REJECTED,
			    .reason = "expired"};
	zassert_true(mc_enc_ack(b, sizeof(b), &a) > 0);
	zassert_str_equal(b, "{\"id\":\"01J8ZQ6H7K2M4N5P6Q7R8S9T0V\",\"status\":\"rejected\","
			     "\"reason\":\"expired\"}");
}

ZTEST(payload, test_config_state_applied_and_rejected)
{
	struct mc_config c;
	struct mc_error err = {.slot = 2, .code = "pin_not_output"};
	char b[CAP];

	mc_config_init(&c);
	c.rev = 7;
	c.wake_interval_s = 600;
	c.n = 2;
	c.slots[0] = (struct mc_slot){.slot = 0, .module = MC_MOD_MOISTURE_CAPACITIVE, .pin = 34,
				      .cal_dry = 3000, .cal_wet = 1200};
	c.slots[1] = (struct mc_slot){.slot = 2, .module = MC_MOD_PUMP_RELAY, .pin = 25,
				      .active_high = true, .max_run_s = 60, .min_pause_s = 600};
	strcpy(err.detail, "GPIO 34 is input-only");

	zassert_true(mc_enc_config_state(b, sizeof(b), &c, MC_CFG_REJECTED, 8, &err) > 0);
	zassert_str_equal(b,
		"{\"rev\":7,\"result\":\"rejected\",\"rejected_rev\":8,\"error\":{\"slot\":2,"
		"\"code\":\"pin_not_output\",\"detail\":\"GPIO 34 is input-only\"},"
		"\"wake_interval_s\":600,\"awake_s\":0,\"slots\":["
		"{\"slot\":0,\"module\":\"moisture_capacitive\",\"pin\":34,"
		"\"cal\":{\"dry\":3000,\"wet\":1200}},"
		"{\"slot\":2,\"module\":\"pump_relay\",\"pin\":25,\"active_high\":true,"
		"\"max_run_s\":60,\"min_pause_s\":600}],\"detected\":[],"
		"\"limits\":{\"max_run_s_hard\":300,\"slots_max\":6}}");
	zassert_true(mc_enc_config_state(b, sizeof(b), &c, MC_CFG_BOOT, 0, NULL) > 0);
	zassert_not_null(strstr(b, "\"result\":\"boot\""));
	zassert_is_null(strstr(b, "rejected_rev"));
}

ZTEST(payload, test_too_small_buffer_fails)
{
	char b[10];

	zassert_equal(mc_enc_status_online(b, sizeof(b), 1), -1);
}

ZTEST_SUITE(payload, NULL, NULL, NULL, NULL, NULL);
```

## src/test_sensor_rtc.c
```c
#include <zephyr/ztest.h>
#include <string.h>

#include "mc_rtc.h"
#include "mc_sensor.h"

ZTEST(sensor, test_moisture_calibration)
{
	int32_t v;

	/* dry 3000 = 0 %, wet 1200 = 100 % */
	zassert_equal(mc_moisture_convert(3000, 3000, 1200, &v), MC_SENSOR_OK);
	zassert_equal(v, 0);
	zassert_equal(mc_moisture_convert(1200, 3000, 1200, &v), MC_SENSOR_OK);
	zassert_equal(v, 1000);
	zassert_equal(mc_moisture_convert(2100, 3000, 1200, &v), MC_SENSOR_OK);
	zassert_equal(v, 500);
	zassert_equal(mc_moisture_convert(2143, 3000, 1200, &v), MC_SENSOR_OK);
	zassert_equal(v, 476); /* 47.6 % */
	/* slightly outside the span is clamped, far outside is an error */
	zassert_equal(mc_moisture_convert(3100, 3000, 1200, &v), MC_SENSOR_OK);
	zassert_equal(v, 0);
	zassert_equal(mc_moisture_convert(1100, 3000, 1200, &v), MC_SENSOR_OK);
	zassert_equal(v, 1000);
	zassert_equal(mc_moisture_convert(3500, 3000, 1200, &v), MC_SENSOR_OUT_OF_RANGE);
	zassert_equal(mc_moisture_convert(800, 3000, 1200, &v), MC_SENSOR_OUT_OF_RANGE);
}

ZTEST(sensor, test_nothing_connected)
{
	int32_t v;

	zassert_equal(mc_moisture_convert(4095, 3000, 1200, &v), MC_SENSOR_NO_SIGNAL);
	zassert_equal(mc_moisture_convert(0, 3000, 1200, &v), MC_SENSOR_NO_SIGNAL);
}

ZTEST(sensor, test_resistive_orientation_is_handled)
{
	int32_t v;

	/* a sensor that reads higher when wet: dry < wet */
	zassert_equal(mc_moisture_convert(1000, 1000, 3000, &v), MC_SENSOR_OK);
	zassert_equal(v, 0);
	zassert_equal(mc_moisture_convert(2000, 1000, 3000, &v), MC_SENSOR_OK);
	zassert_equal(v, 500);
}

ZTEST(sensor, test_reading_from_slot)
{
	struct mc_slot s = {.slot = 1, .module = MC_MOD_MOISTURE_CAPACITIVE, .cal_dry = 3000,
			    .cal_wet = 1200};
	struct mc_reading r;

	mc_moisture_reading(&s, 2100, &r);
	zassert_true(r.has_value && r.has_raw);
	zassert_equal(r.slot, 1);
	zassert_equal(r.value_x10, 500);
	mc_moisture_reading(&s, 4095, &r);
	zassert_false(r.has_value);
	zassert_equal(r.err, MC_SENSOR_NO_SIGNAL);
	zassert_equal(r.raw, 4095);
}

ZTEST_SUITE(sensor, NULL, NULL, NULL, NULL, NULL);

static struct mc_rtc rtc;

static void before(void *f)
{
	mc_rtc_init(&rtc);
}

static struct mc_tel tel(uint32_t seq)
{
	return (struct mc_tel){.seq = seq, .n = 0};
}

ZTEST(rtc, test_crc_detects_power_loss_and_corruption)
{
	zassert_false(mc_rtc_valid(&rtc)); /* not sealed yet */
	mc_rtc_seal(&rtc);
	zassert_true(mc_rtc_valid(&rtc));
	rtc.seq++;
	zassert_false(mc_rtc_valid(&rtc));
	mc_rtc_seal(&rtc);
	zassert_true(mc_rtc_valid(&rtc));

	struct mc_rtc garbage;

	memset(&garbage, 0xA5, sizeof(garbage));
	zassert_false(mc_rtc_valid(&garbage));
	memset(&garbage, 0, sizeof(garbage));
	zassert_false(mc_rtc_valid(&garbage));
}

ZTEST(rtc, test_fits_in_retained_ram)
{
	zassert_true(sizeof(struct mc_rtc) <= 4000, "%u bytes", (unsigned)sizeof(struct mc_rtc));
}

ZTEST(rtc, test_seq_is_monotonic)
{
	zassert_equal(mc_rtc_next_seq(&rtc), 1);
	zassert_equal(mc_rtc_next_seq(&rtc), 2);
}

ZTEST(rtc, test_buffer_keeps_order_and_drops_oldest)
{
	zassert_is_null(mc_tbuf_oldest(&rtc));
	for (uint32_t i = 1; i <= 9; i++) { /* 3 more than the 6 it holds */
		struct mc_tel t = tel(i);

		mc_tbuf_push(&rtc, &t);
	}
	zassert_equal(rtc.t_count, MC_TELEMETRY_BUFFER);
	for (uint32_t expect = 4; expect <= 9; expect++) {
		const struct mc_tel *t = mc_tbuf_oldest(&rtc);

		zassert_not_null(t);
		zassert_equal(t->seq, expect);
		mc_tbuf_drop_oldest(&rtc);
	}
	zassert_is_null(mc_tbuf_oldest(&rtc));
	mc_tbuf_drop_oldest(&rtc); /* harmless when empty */
}

ZTEST(rtc, test_next_wake_interval)
{
	struct mc_config cfg;

	mc_config_init(&cfg);
	cfg.wake_interval_s = 600;

	struct mc_ctx ctx = {.cfg = &cfg, .now = 1000, .time_synced = true, .hist = &rtc.hist};

	zassert_equal(mc_next_wake_s(&ctx, 3900), 600);
	zassert_equal(mc_next_wake_s(&ctx, 3200), 1800); /* low battery: less often */
	zassert_equal(mc_next_wake_s(&ctx, 0), 600);     /* no battery reading */
	cfg.wake_interval_s = 40000;
	zassert_equal(mc_next_wake_s(&ctx, 3200), MC_WAKE_INTERVAL_MAX_S);
	cfg.wake_interval_s = 600;
	/* a held pump run ends in 90 s: wake for that instead */
	mc_pump_begin_hold(&ctx.pump[2], "X", 1090);
	zassert_equal(mc_next_wake_s(&ctx, 3900), 90);
	ctx.now = 1095; /* overdue: wake right away */
	zassert_equal(mc_next_wake_s(&ctx, 3900), 1);
}

ZTEST(rtc, test_interval_zero_never_sleeps_except_on_a_flat_battery)
{
	struct mc_config cfg;

	mc_config_init(&cfg);
	struct mc_ctx ctx = {.cfg = &cfg, .now = 1000, .time_synced = true, .hist = &rtc.hist};

	zassert_equal(cfg.wake_interval_s, 0);
	zassert_equal(mc_next_wake_s(&ctx, 3900), 0);
	zassert_equal(mc_next_wake_s(&ctx, 0), 0);
	zassert_equal(mc_next_wake_s(&ctx, 3200), 3 * MC_SLEEP_FALLBACK_S);
}

ZTEST_SUITE(rtc, NULL, NULL, before, NULL, NULL);

#include "mc_pins.h"

ZTEST(pins, test_adc_mapping_matches_the_esp32)
{
	int unit, ch;

	zassert_true(mc_pin_adc(34, &unit, &ch));
	zassert_equal(unit, 1);
	zassert_equal(ch, 6);
	zassert_true(mc_pin_adc(36, &unit, &ch));
	zassert_equal(ch, 0);
	zassert_true(mc_pin_adc(39, &unit, &ch));
	zassert_equal(ch, 3);
	zassert_true(mc_pin_adc(32, &unit, &ch));
	zassert_equal(ch, 4);
	zassert_true(mc_pin_adc(15, &unit, &ch));
	zassert_equal(unit, 2);
	zassert_equal(ch, 3); /* "D15 is ADC2 channel 3" */
	zassert_true(mc_pin_adc(25, &unit, &ch));
	zassert_equal(ch, 8);
	zassert_true(mc_pin_adc(27, &unit, &ch));
	zassert_equal(ch, 7);
	zassert_false(mc_pin_adc(5, &unit, &ch));
	zassert_false(mc_pin_adc(40, &unit, &ch));
	zassert_false(mc_pin_adc(-1, &unit, &ch));
}

ZTEST(pins, test_every_adc_pin_the_config_allows_is_mapped)
{
	/* the pins the config accepts for moisture sensors (mc_config.c adc_mask) */
	static const int allowed[] = {32, 33, 34, 35, 36, 39, 4, 12, 13, 14, 15, 25, 26, 27};
	int unit, ch;

	for (size_t i = 0; i < ARRAY_SIZE(allowed); i++) {
		zassert_true(mc_pin_adc(allowed[i], &unit, &ch), "GPIO %d", allowed[i]);
	}
}

ZTEST(pins, test_rtc_pins)
{
	zassert_true(mc_pin_rtc_capable(25));
	zassert_true(mc_pin_rtc_capable(32));
	zassert_false(mc_pin_rtc_capable(5));
	zassert_false(mc_pin_rtc_capable(18));
	zassert_false(mc_pin_rtc_capable(23));
}

ZTEST_SUITE(pins, NULL, NULL, NULL, NULL, NULL);
```
